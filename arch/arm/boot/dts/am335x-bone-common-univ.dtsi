// SPDX-License-Identifier: GPL-2.0-only
/*
 * Copyright (C) 2012 Texas Instruments Incorporated - http://www.ti.com/
 */

#include <dt-bindings/board/am335x-bone-pins.h>

&am33xx_pinmux {
	/************************/
	/* P8 Header */
	/************************/

	/* P8_01                GND */

	/* P8_02                GND */


	/* P8_03 (ZCZ ball R9) emmc */

	/* P8_04 (ZCZ ball T9) emmc */

	/* P8_05 (ZCZ ball R8) emmc */

	/* P8_05 dummy nodes for unavailable bone bus pins*/

	/* P8_06 (ZCZ ball T8) emmc */

	/* P8_06 dummy nodes for unavailable bone bus pins*/

	/* P8_07 (ZCZ ball R7) gpio2_2 */
	P8_07_default_pin: pinmux_P8_07_default_pin { pinctrl-single,pins = <
		P8_07( PIN_OUTPUT_PULLUP | INPUT_EN | MUX_MODE7) >; };	/* gpmc_advn_ale.gpio2_2 */
	P8_07_gpio_pin: pinmux_P8_07_gpio_pin { pinctrl-single,pins = <
		P8_07( PIN_OUTPUT | INPUT_EN | MUX_MODE7) >; };		/* gpmc_advn_ale.gpio2_2 */
	P8_07_gpio_pu_pin: pinmux_P8_07_gpio_pu_pin { pinctrl-single,pins = <
		P8_07( PIN_OUTPUT_PULLUP | INPUT_EN | MUX_MODE7) >; };	/* gpmc_advn_ale.gpio2_2 */
	P8_07_gpio_pd_pin: pinmux_P8_07_gpio_pd_pin { pinctrl-single,pins = <
		P8_07( PIN_OUTPUT_PULLDOWN | INPUT_EN | MUX_MODE7) >; };	/* gpmc_advn_ale.gpio2_2 */
	P8_07_timer_pin: pinmux_P8_07_timer_pin { pinctrl-single,pins = <
		P8_07( PIN_OUTPUT_PULLUP | INPUT_EN | MUX_MODE2) >; };	/* gpmc_advn_ale.timer4 */

	/* P8_08 (ZCZ ball T7) gpio2_3 */
	P8_08_default_pin: pinmux_P8_08_default_pin { pinctrl-single,pins = <
		P8_08( PIN_OUTPUT_PULLUP | INPUT_EN | MUX_MODE7) >; };	/* gpmc_oen_ren.gpio2_3 */
	P8_08_gpio_pin: pinmux_P8_08_gpio_pin { pinctrl-single,pins = <
		P8_08( PIN_OUTPUT | INPUT_EN | MUX_MODE7) >; };		/* gpmc_oen_ren.gpio2_3 */
	P8_08_gpio_pu_pin: pinmux_P8_08_gpio_pu_pin { pinctrl-single,pins = <
		P8_08( PIN_OUTPUT_PULLUP | INPUT_EN | MUX_MODE7) >; };	/* gpmc_oen_ren.gpio2_3 */
	P8_08_gpio_pd_pin: pinmux_P8_08_gpio_pd_pin { pinctrl-single,pins = <
		P8_08( PIN_OUTPUT_PULLDOWN | INPUT_EN | MUX_MODE7) >; };	/* gpmc_oen_ren.gpio2_3 */
	P8_08_timer_pin: pinmux_P8_08_timer_pin { pinctrl-single,pins = <
		P8_08( PIN_OUTPUT_PULLUP | INPUT_EN | MUX_MODE2) >; };	/* gpmc_oen_ren.timer7 */

	/* P8_09 (ZCZ ball T6) gpio2_5 */
	P8_09_default_pin: pinmux_P8_09_default_pin { pinctrl-single,pins = <
		P8_09( PIN_OUTPUT_PULLUP | INPUT_EN | MUX_MODE7) >; };	/* gpmc_be0n_cle.gpio2_5 */
	P8_09_gpio_pin: pinmux_P8_09_gpio_pin { pinctrl-single,pins = <
		P8_09( PIN_OUTPUT | INPUT_EN | MUX_MODE7) >; };		/* gpmc_be0n_cle.gpio2_5 */
	P8_09_gpio_pu_pin: pinmux_P8_09_gpio_pu_pin { pinctrl-single,pins = <
		P8_09( PIN_OUTPUT_PULLUP | INPUT_EN | MUX_MODE7) >; };	/* gpmc_be0n_cle.gpio2_5 */
	P8_09_gpio_pd_pin: pinmux_P8_09_gpio_pd_pin { pinctrl-single,pins = <
		P8_09( PIN_OUTPUT_PULLDOWN | INPUT_EN | MUX_MODE7) >; };	/* gpmc_be0n_cle.gpio2_5 */
	P8_09_timer_pin: pinmux_P8_09_timer_pin { pinctrl-single,pins = <
		P8_09( PIN_OUTPUT_PULLUP | INPUT_EN | MUX_MODE2) >; };	/* gpmc_be0n_cle.timer5 */

	/* P8_10 (ZCZ ball U6) gpio2_4 */
	P8_10_default_pin: pinmux_P8_10_default_pin { pinctrl-single,pins = <
		P8_10( PIN_OUTPUT_PULLUP | INPUT_EN | MUX_MODE7) >; };	/* gpmc_wen.gpio2_4 */
	P8_10_gpio_pin: pinmux_P8_10_gpio_pin { pinctrl-single,pins = <
		P8_10( PIN_OUTPUT | INPUT_EN | MUX_MODE7) >; };		/* gpmc_wen.gpio2_4 */
	P8_10_gpio_pu_pin: pinmux_P8_10_gpio_pu_pin { pinctrl-single,pins = <
		P8_10( PIN_OUTPUT_PULLUP | INPUT_EN | MUX_MODE7) >; };	/* gpmc_wen.gpio2_4 */
	P8_10_gpio_pd_pin: pinmux_P8_10_gpio_pd_pin { pinctrl-single,pins = <
		P8_10( PIN_OUTPUT_PULLDOWN | INPUT_EN | MUX_MODE7) >; };	/* gpmc_wen.gpio2_4 */
	P8_10_timer_pin: pinmux_P8_10_timer_pin { pinctrl-single,pins = <
		P8_10( PIN_OUTPUT_PULLUP | INPUT_EN | MUX_MODE2) >; };	/* gpmc_wen.timer6 */

	/* P8_11 (ZCZ ball R12) gpio1_13 */
	P8_11_default_pin: pinmux_P8_11_default_pin { pinctrl-single,pins = <
		P8_11( PIN_OUTPUT_PULLDOWN | INPUT_EN | MUX_MODE7) >; };	/* gpmc_ad13.gpio1_13 */
	P8_11_gpio_pin: pinmux_P8_11_gpio_pin { pinctrl-single,pins = <
		P8_11( PIN_OUTPUT | INPUT_EN | MUX_MODE7) >; };		/* gpmc_ad13.gpio1_13 */
	P8_11_gpio_pu_pin: pinmux_P8_11_gpio_pu_pin { pinctrl-single,pins = <
		P8_11( PIN_OUTPUT_PULLUP | INPUT_EN | MUX_MODE7) >; };	/* gpmc_ad13.gpio1_13 */
	P8_11_gpio_pd_pin: pinmux_P8_11_gpio_pd_pin { pinctrl-single,pins = <
		P8_11( PIN_OUTPUT_PULLDOWN | INPUT_EN | MUX_MODE7) >; };	/* gpmc_ad13.gpio1_13 */
	P8_11_eqep_pin: pinmux_P8_11_eqep_pin { pinctrl-single,pins = <
		P8_11( PIN_OUTPUT_PULLUP | INPUT_EN | MUX_MODE4) >; };	/* gpmc_ad13.eqep2b_in */
	P8_11_pruout_pin: pinmux_P8_11_pruout_pin { pinctrl-single,pins = <
		P8_11( PIN_OUTPUT_PULLDOWN | INPUT_EN | MUX_MODE6) >; };	/* gpmc_ad13.pru0_out15 */

	/* P8_12 (ZCZ ball T12) gpio1_12 */
	P8_12_default_pin: pinmux_P8_12_default_pin { pinctrl-single,pins = <
		P8_12( PIN_OUTPUT_PULLDOWN | INPUT_EN | MUX_MODE7) >; };	/* gpmc_ad12.gpio1_12 */
	P8_12_gpio_pin: pinmux_P8_12_gpio_pin { pinctrl-single,pins = <
		P8_12( PIN_OUTPUT | INPUT_EN | MUX_MODE7) >; };		/* gpmc_ad12.gpio1_12 */
	P8_12_gpio_pu_pin: pinmux_P8_12_gpio_pu_pin { pinctrl-single,pins = <
		P8_12( PIN_OUTPUT_PULLUP | INPUT_EN | MUX_MODE7) >; };	/* gpmc_ad12.gpio1_12 */
	P8_12_gpio_pd_pin: pinmux_P8_12_gpio_pd_pin { pinctrl-single,pins = <
		P8_12( PIN_OUTPUT_PULLDOWN | INPUT_EN | MUX_MODE7) >; };	/* gpmc_ad12.gpio1_12 */
	P8_12_eqep_pin: pinmux_P8_12_eqep_pin { pinctrl-single,pins = <
		P8_12( PIN_OUTPUT_PULLUP | INPUT_EN | MUX_MODE4) >; };	/* gpmc_ad12.eqep2a_in */
	P8_12_pruout_pin: pinmux_P8_12_pruout_pin { pinctrl-single,pins = <
		P8_12( PIN_OUTPUT_PULLDOWN | INPUT_EN | MUX_MODE6) >; };	/* gpmc_ad12.pru0_out14 */

	/* P8_13 (ZCZ ball T10) gpio0_23 */
	P8_13_default_pin: pinmux_P8_13_default_pin { pinctrl-single,pins = <
		P8_13( PIN_OUTPUT_PULLDOWN | INPUT_EN | MUX_MODE7) >; };	/* gpmc_ad9.gpio0_23 */
	P8_13_gpio_pin: pinmux_P8_13_gpio_pin { pinctrl-single,pins = <
		P8_13( PIN_OUTPUT | INPUT_EN | MUX_MODE7) >; };		/* gpmc_ad9.gpio0_23 */
	P8_13_gpio_pu_pin: pinmux_P8_13_gpio_pu_pin { pinctrl-single,pins = <
		P8_13( PIN_OUTPUT_PULLUP | INPUT_EN | MUX_MODE7) >; };	/* gpmc_ad9.gpio0_23 */
	P8_13_gpio_pd_pin: pinmux_P8_13_gpio_pd_pin { pinctrl-single,pins = <
		P8_13( PIN_OUTPUT_PULLDOWN | INPUT_EN | MUX_MODE7) >; };	/* gpmc_ad9.gpio0_23 */
	P8_13_pwm_pin: pinmux_P8_13_pwm_pin { pinctrl-single,pins = <
		P8_13( PIN_OUTPUT_PULLDOWN | INPUT_EN | MUX_MODE4) >; };	/* gpmc_ad9.ehrpwm2b */

	/* P8_14 (ZCZ ball T11) gpio0_26 */
	P8_14_default_pin: pinmux_P8_14_default_pin { pinctrl-single,pins = <
		P8_14( PIN_OUTPUT_PULLDOWN | INPUT_EN | MUX_MODE7) >; };	/* gpmc_ad10.gpio0_26 */
	P8_14_gpio_pin: pinmux_P8_14_gpio_pin { pinctrl-single,pins = <
		P8_14( PIN_OUTPUT | INPUT_EN | MUX_MODE7) >; };		/* gpmc_ad10.gpio0_26 */
	P8_14_gpio_pu_pin: pinmux_P8_14_gpio_pu_pin { pinctrl-single,pins = <
		P8_14( PIN_OUTPUT_PULLUP | INPUT_EN | MUX_MODE7) >; };	/* gpmc_ad10.gpio0_26 */
	P8_14_gpio_pd_pin: pinmux_P8_14_gpio_pd_pin { pinctrl-single,pins = <
		P8_14( PIN_OUTPUT_PULLDOWN | INPUT_EN | MUX_MODE7) >; };	/* gpmc_ad10.gpio0_26 */
	P8_14_pwm_pin: pinmux_P8_14_pwm_pin { pinctrl-single,pins = <
		P8_14( PIN_OUTPUT_PULLDOWN | INPUT_EN | MUX_MODE4) >; };	/* gpmc_ad10.ehrpwm2_tripzone_input */

	/* P8_15 (ZCZ ball U13) gpio1_15 */
	P8_15_default_pin: pinmux_P8_15_default_pin { pinctrl-single,pins = <
		P8_15( PIN_OUTPUT_PULLDOWN | INPUT_EN | MUX_MODE7) >; };	/* gpmc_ad15.gpio1_15 */
	P8_15_gpio_pin: pinmux_P8_15_gpio_pin { pinctrl-single,pins = <
		P8_15( PIN_OUTPUT | INPUT_EN | MUX_MODE7) >; };		/* gpmc_ad15.gpio1_15 */
	P8_15_gpio_pu_pin: pinmux_P8_15_gpio_pu_pin { pinctrl-single,pins = <
		P8_15( PIN_OUTPUT_PULLUP | INPUT_EN | MUX_MODE7) >; };	/* gpmc_ad15.gpio1_15 */
	P8_15_gpio_pd_pin: pinmux_P8_15_gpio_pd_pin { pinctrl-single,pins = <
		P8_15( PIN_OUTPUT_PULLDOWN | INPUT_EN | MUX_MODE7) >; };	/* gpmc_ad15.gpio1_15 */
	P8_15_eqep_pin: pinmux_P8_15_eqep_pin { pinctrl-single,pins = <
		P8_15( PIN_OUTPUT_PULLUP | INPUT_EN | MUX_MODE4) >; };	/* gpmc_ad15.eqep2_strobe */
	P8_15_pru_ecap_pwm_pin: pinmux_P8_15_pru_ecap_pwm_pin { pinctrl-single,pins = <
		P8_15( PIN_OUTPUT_PULLDOWN | INPUT_EN | MUX_MODE5) >; };	/* gpmc_ad15.pr1_ecap0_ecap_capin_apwm_o */
	P8_15_pruin_pin: pinmux_P8_15_pruin_pin { pinctrl-single,pins = <
		P8_15( PIN_INPUT | MUX_MODE6) >; };			/* gpmc_ad15.pru0_in15 */

	/* P8_16 (ZCZ ball V13) gpio1_14 */
	P8_16_default_pin: pinmux_P8_16_default_pin { pinctrl-single,pins = <
		P8_16( PIN_OUTPUT_PULLDOWN | INPUT_EN | MUX_MODE7) >; };	/* gpmc_ad14.gpio1_14 */
	P8_16_gpio_pin: pinmux_P8_16_gpio_pin { pinctrl-single,pins = <
		P8_16( PIN_OUTPUT | INPUT_EN | MUX_MODE7) >; };		/* gpmc_ad14.gpio1_14 */
	P8_16_gpio_pu_pin: pinmux_P8_16_gpio_pu_pin { pinctrl-single,pins = <
		P8_16( PIN_OUTPUT_PULLUP | INPUT_EN | MUX_MODE7) >; };	/* gpmc_ad14.gpio1_14 */
	P8_16_gpio_pd_pin: pinmux_P8_16_gpio_pd_pin { pinctrl-single,pins = <
		P8_16( PIN_OUTPUT_PULLDOWN | INPUT_EN | MUX_MODE7) >; };	/* gpmc_ad14.gpio1_14 */
	P8_16_eqep_pin: pinmux_P8_16_eqep_pin { pinctrl-single,pins = <
		P8_16( PIN_OUTPUT_PULLUP | INPUT_EN | MUX_MODE4) >; };	/* gpmc_ad14.eqep2_index */
	P8_16_pruin_pin: pinmux_P8_16_pruin_pin { pinctrl-single,pins = <
		P8_16( PIN_INPUT | MUX_MODE6) >; };			/* gpmc_ad14.pru0_in14 */

	/* P8_17 (ZCZ ball U12) gpio0_27 */
	P8_17_default_pin: pinmux_P8_17_default_pin { pinctrl-single,pins = <
		P8_17( PIN_OUTPUT_PULLDOWN | INPUT_EN | MUX_MODE7) >; };	/* gpmc_ad11.gpio0_27 */
	P8_17_gpio_pin: pinmux_P8_17_gpio_pin { pinctrl-single,pins = <
		P8_17( PIN_OUTPUT | INPUT_EN | MUX_MODE7) >; };		/* gpmc_ad11.gpio0_27 */
	P8_17_gpio_pu_pin: pinmux_P8_17_gpio_pu_pin { pinctrl-single,pins = <
		P8_17( PIN_OUTPUT_PULLUP | INPUT_EN | MUX_MODE7) >; };	/* gpmc_ad11.gpio0_27 */
	P8_17_gpio_pd_pin: pinmux_P8_17_gpio_pd_pin { pinctrl-single,pins = <
		P8_17( PIN_OUTPUT_PULLDOWN | INPUT_EN | MUX_MODE7) >; };	/* gpmc_ad11.gpio0_27 */
	P8_17_pwm_pin: pinmux_P8_17_pwm_pin { pinctrl-single,pins = <
		P8_17( PIN_OUTPUT_PULLDOWN | INPUT_EN | MUX_MODE4) >; };	/* gpmc_ad11.ehrpwm0_synco */

	/* P8_18 (ZCZ ball V12) gpio2_1 */
	P8_18_default_pin: pinmux_P8_18_default_pin { pinctrl-single,pins = <
		P8_18( PIN_OUTPUT_PULLDOWN | INPUT_EN | MUX_MODE7) >; };	/* gpmc_clk.gpio2_1 */
	P8_18_gpio_pin: pinmux_P8_18_gpio_pin { pinctrl-single,pins = <
		P8_18( PIN_OUTPUT | INPUT_EN | MUX_MODE7) >; };		/* gpmc_clk.gpio2_1 */
	P8_18_gpio_pu_pin: pinmux_P8_18_gpio_pu_pin { pinctrl-single,pins = <
		P8_18( PIN_OUTPUT_PULLUP | INPUT_EN | MUX_MODE7) >; };	/* gpmc_clk.gpio2_1 */
	P8_18_gpio_pd_pin: pinmux_P8_18_gpio_pd_pin { pinctrl-single,pins = <
		P8_18( PIN_OUTPUT_PULLDOWN | INPUT_EN | MUX_MODE7) >; };	/* gpmc_clk.gpio2_1 */

	/* P8_18 dummy nodes for unavailable bone bus pins*/
	P8_18_eqep_pin: pinmux_P8_18_eqep_pin { pinctrl-single,pins = <
		/* To avoid FDT_ERROR on BBBWL/BBB when using BONE-EQEP2.dtbo */
		/* Default pinmux configuration of P8_18 (P8_18_default_pin) */
		P8_18( PIN_OUTPUT_PULLDOWN | INPUT_EN | MUX_MODE7) >; };	/* gpmc_clk.gpio2_1 */

	/* P8_19 (ZCZ ball U10) gpio0_22 */
	P8_19_default_pin: pinmux_P8_19_default_pin { pinctrl-single,pins = <
		P8_19( PIN_OUTPUT_PULLDOWN | INPUT_EN | MUX_MODE7) >; };	/* gpmc_ad8.gpio0_22 */
	P8_19_gpio_pin: pinmux_P8_19_gpio_pin { pinctrl-single,pins = <
		P8_19( PIN_OUTPUT | INPUT_EN | MUX_MODE7) >; };		/* gpmc_ad8.gpio0_22 */
	P8_19_gpio_pu_pin: pinmux_P8_19_gpio_pu_pin { pinctrl-single,pins = <
		P8_19( PIN_OUTPUT_PULLUP | INPUT_EN | MUX_MODE7) >; };	/* gpmc_ad8.gpio0_22 */
	P8_19_gpio_pd_pin: pinmux_P8_19_gpio_pd_pin { pinctrl-single,pins = <
		P8_19( PIN_OUTPUT_PULLDOWN | INPUT_EN | MUX_MODE7) >; };	/* gpmc_ad8.gpio0_22 */
	P8_19_pwm_pin: pinmux_P8_19_pwm_pin { pinctrl-single,pins = <
		P8_19( PIN_OUTPUT_PULLDOWN | INPUT_EN | MUX_MODE4) >; };	/* gpmc_ad8.ehrpwm2a */

	/* P8_20 (ZCZ ball V9) emmc */

	/* P8_21 (ZCZ ball U9) emmc */

	/* P8_22 (ZCZ ball V8) emmc */

	/* P8_23 (ZCZ ball U8) emmc */

	/* P8_24 (ZCZ ball V7) emmc */

	/* P8_25 (ZCZ ball U7) emmc */

	/* P8_26 (ZCZ ball V6) gpio1_29 */
	P8_26_default_pin: pinmux_P8_26_default_pin { pinctrl-single,pins = <
		P8_26( PIN_OUTPUT_PULLUP | INPUT_EN | MUX_MODE7) >; };	/* gpmc_csn0.gpio1_29 */
	P8_26_gpio_pin: pinmux_P8_26_gpio_pin { pinctrl-single,pins = <
		P8_26( PIN_OUTPUT | INPUT_EN | MUX_MODE7) >; };		/* gpmc_csn0.gpio1_29 */
	P8_26_gpio_pu_pin: pinmux_P8_26_gpio_pu_pin { pinctrl-single,pins = <
		P8_26( PIN_OUTPUT_PULLUP | INPUT_EN | MUX_MODE7) >; };	/* gpmc_csn0.gpio1_29 */
	P8_26_gpio_pd_pin: pinmux_P8_26_gpio_pd_pin { pinctrl-single,pins = <
		P8_26( PIN_OUTPUT_PULLDOWN | INPUT_EN | MUX_MODE7) >; };	/* gpmc_csn0.gpio1_29 */

	/* P8_27 (ZCZ ball U5) hdmi */
	P8_27_default_pin: pinmux_P8_27_default_pin { pinctrl-single,pins = <
		P8_27( PIN_OUTPUT_PULLDOWN | INPUT_EN | MUX_MODE7) >; };	/* lcd_vsync.gpio2_22 */
	P8_27_gpio_pin: pinmux_P8_27_gpio_pin { pinctrl-single,pins = <
		P8_27( PIN_OUTPUT | INPUT_EN | MUX_MODE7) >; };		/* lcd_vsync.gpio2_22 */
	P8_27_gpio_pu_pin: pinmux_P8_27_gpio_pu_pin { pinctrl-single,pins = <
		P8_27( PIN_OUTPUT_PULLUP | INPUT_EN | MUX_MODE7) >; };	/* lcd_vsync.gpio2_22 */
	P8_27_gpio_pd_pin: pinmux_P8_27_gpio_pd_pin { pinctrl-single,pins = <
		P8_27( PIN_OUTPUT_PULLDOWN | INPUT_EN | MUX_MODE7) >; };	/* lcd_vsync.gpio2_22 */
	P8_27_pruout_pin: pinmux_P8_27_pruout_pin { pinctrl-single,pins = <
		P8_27( PIN_OUTPUT_PULLDOWN | INPUT_EN | MUX_MODE5) >; };	/* lcd_vsync.pru1_out8 */
	P8_27_pruin_pin: pinmux_P8_27_pruin_pin { pinctrl-single,pins = <
		P8_27( PIN_INPUT | MUX_MODE6) >; };			/* lcd_vsync.pru1_in8 */
	P8_27_lcd_pin: pinmux_P8_27_lcd_pin { pinctrl-single,pins = <
		P8_27( PIN_OUTPUT | MUX_MODE0) >; };			/* lcd_vsync.lcd_vsync */

	/* P8_28 (ZCZ ball V5) hdmi */
	P8_28_default_pin: pinmux_P8_28_default_pin { pinctrl-single,pins = <
		P8_28( PIN_OUTPUT_PULLDOWN | INPUT_EN | MUX_MODE7) >; };	/* lcd_pclk.gpio2_24 */
	P8_28_gpio_pin: pinmux_P8_28_gpio_pin { pinctrl-single,pins = <
		P8_28( PIN_OUTPUT | INPUT_EN | MUX_MODE7) >; };		/* lcd_pclk.gpio2_24 */
	P8_28_gpio_pu_pin: pinmux_P8_28_gpio_pu_pin { pinctrl-single,pins = <
		P8_28( PIN_OUTPUT_PULLUP | INPUT_EN | MUX_MODE7) >; };	/* lcd_pclk.gpio2_24 */
	P8_28_gpio_pd_pin: pinmux_P8_28_gpio_pd_pin { pinctrl-single,pins = <
		P8_28( PIN_OUTPUT_PULLDOWN | INPUT_EN | MUX_MODE7) >; };	/* lcd_pclk.gpio2_24 */
	P8_28_pruout_pin: pinmux_P8_28_pruout_pin { pinctrl-single,pins = <
		P8_28( PIN_OUTPUT_PULLDOWN | INPUT_EN | MUX_MODE5) >; };	/* lcd_pclk.pru1_out10 */
	P8_28_pruin_pin: pinmux_P8_28_pruin_pin { pinctrl-single,pins = <
		P8_28( PIN_INPUT | MUX_MODE6) >; };			/* lcd_pclk.pru1_in10 */
	P8_28_lcd_pin: pinmux_P8_28_lcd_pin { pinctrl-single,pins = <
		P8_28( PIN_OUTPUT | MUX_MODE0) >; };			/* lcd_pclk.lcd_pclk */

	/* P8_29 (ZCZ ball R5) hdmi */
	P8_29_default_pin: pinmux_P8_29_default_pin { pinctrl-single,pins = <
		P8_29( PIN_OUTPUT_PULLDOWN | INPUT_EN | MUX_MODE7) >; };	/* lcd_hsync.gpio2_23 */
	P8_29_gpio_pin: pinmux_P8_29_gpio_pin { pinctrl-single,pins = <
		P8_29( PIN_OUTPUT | INPUT_EN | MUX_MODE7) >; };		/* lcd_hsync.gpio2_23 */
	P8_29_gpio_pu_pin: pinmux_P8_29_gpio_pu_pin { pinctrl-single,pins = <
		P8_29( PIN_OUTPUT_PULLUP | INPUT_EN | MUX_MODE7) >; };	/* lcd_hsync.gpio2_23 */
	P8_29_gpio_pd_pin: pinmux_P8_29_gpio_pd_pin { pinctrl-single,pins = <
		P8_29( PIN_OUTPUT_PULLDOWN | INPUT_EN | MUX_MODE7) >; };	/* lcd_hsync.gpio2_23 */
	P8_29_pruout_pin: pinmux_P8_29_pruout_pin { pinctrl-single,pins = <
		P8_29( PIN_OUTPUT_PULLDOWN | INPUT_EN | MUX_MODE5) >; };	/* lcd_hsync.pru1_out9 */
	P8_29_pruin_pin: pinmux_P8_29_pruin_pin { pinctrl-single,pins = <
		P8_29( PIN_INPUT | MUX_MODE6) >; };			/* lcd_hsync.pru1_in9 */
	P8_29_lcd_pin: pinmux_P8_29_lcd_pin { pinctrl-single,pins = <
		P8_29( PIN_OUTPUT | MUX_MODE0) >; };			/* lcd_hsync.lcd_hsync */

	/* P8_30 (ZCZ ball R6) hdmi */
	P8_30_default_pin: pinmux_P8_30_default_pin { pinctrl-single,pins = <
		P8_30( PIN_OUTPUT_PULLDOWN | INPUT_EN | MUX_MODE7) >; };	/* lcd_ac_bias_en.gpio2_25 */
	P8_30_gpio_pin: pinmux_P8_30_gpio_pin { pinctrl-single,pins = <
		P8_30( PIN_OUTPUT | INPUT_EN | MUX_MODE7) >; };		/* lcd_ac_bias_en.gpio2_25 */
	P8_30_gpio_pu_pin: pinmux_P8_30_gpio_pu_pin { pinctrl-single,pins = <
		P8_30( PIN_OUTPUT_PULLUP | INPUT_EN | MUX_MODE7) >; };	/* lcd_ac_bias_en.gpio2_25 */
	P8_30_gpio_pd_pin: pinmux_P8_30_gpio_pd_pin { pinctrl-single,pins = <
		P8_30( PIN_OUTPUT_PULLDOWN | INPUT_EN | MUX_MODE7) >; };	/* lcd_ac_bias_en.gpio2_25 */
	P8_30_pruout_pin: pinmux_P8_30_pruout_pin { pinctrl-single,pins = <
		P8_30( PIN_OUTPUT_PULLDOWN | INPUT_EN | MUX_MODE5) >; };	/* lcd_ac_bias_en.pru1_out11 */
	P8_30_pruin_pin: pinmux_P8_30_pruin_pin { pinctrl-single,pins = <
		P8_30( PIN_INPUT | MUX_MODE6) >; };			/* lcd_ac_bias_en.pru1_in11 */
	P8_30_lcd_pin: pinmux_P8_30_lcd_pin { pinctrl-single,pins = <
		P8_30( PIN_OUTPUT | MUX_MODE0) >; };			/* lcd_ac_bias_en.lcd_ac_bias_en */

	/* P8_31 (ZCZ ball V4) hdmi */
	P8_31_default_pin: pinmux_P8_31_default_pin { pinctrl-single,pins = <
		P8_31( PIN_OUTPUT_PULLDOWN | INPUT_EN | MUX_MODE7) >; };	/* lcd_data14.gpio0_10 */
	P8_31_gpio_pin: pinmux_P8_31_gpio_pin { pinctrl-single,pins = <
		P8_31( PIN_OUTPUT | INPUT_EN | MUX_MODE7) >; };		/* lcd_data14.gpio0_10 */
	P8_31_gpio_pu_pin: pinmux_P8_31_gpio_pu_pin { pinctrl-single,pins = <
		P8_31( PIN_OUTPUT_PULLUP | INPUT_EN | MUX_MODE7) >; };	/* lcd_data14.gpio0_10 */
	P8_31_gpio_pd_pin: pinmux_P8_31_gpio_pd_pin { pinctrl-single,pins = <
		P8_31( PIN_OUTPUT_PULLDOWN | INPUT_EN | MUX_MODE7) >; };	/* lcd_data14.gpio0_10 */
	P8_31_eqep_pin: pinmux_P8_31_eqep_pin { pinctrl-single,pins = <
		P8_31( PIN_OUTPUT_PULLUP | INPUT_EN | MUX_MODE2) >; };	/* lcd_data14.eqep1_index */
	P8_31_uart_pin: pinmux_P8_31_uart_pin { pinctrl-single,pins = <
		P8_31( PIN_OUTPUT_PULLUP | INPUT_EN | MUX_MODE4) >; };	/* lcd_data14.uart5_rxd */
	P8_31_lcd_pin: pinmux_P8_31_lcd_pin { pinctrl-single,pins = <
		P8_31( PIN_OUTPUT | MUX_MODE0) >; };	/* lcd_data14.lcd_data14 */

	/* P8_32 (ZCZ ball T5) hdmi */
	P8_32_default_pin: pinmux_P8_32_default_pin { pinctrl-single,pins = <
		P8_32( PIN_OUTPUT_PULLDOWN | INPUT_EN | MUX_MODE7) >; };	/* lcd_data15.gpio0_11 */
	P8_32_gpio_pin: pinmux_P8_32_gpio_pin { pinctrl-single,pins = <
		P8_32( PIN_OUTPUT | INPUT_EN | MUX_MODE7) >; };		/* lcd_data15.gpio0_11 */
	P8_32_gpio_pu_pin: pinmux_P8_32_gpio_pu_pin { pinctrl-single,pins = <
		P8_32( PIN_OUTPUT_PULLUP | INPUT_EN | MUX_MODE7) >; };	/* lcd_data15.gpio0_11 */
	P8_32_gpio_pd_pin: pinmux_P8_32_gpio_pd_pin { pinctrl-single,pins = <
		P8_32( PIN_OUTPUT_PULLDOWN | INPUT_EN | MUX_MODE7) >; };	/* lcd_data15.gpio0_11 */
	P8_32_eqep_pin: pinmux_P8_32_eqep_pin { pinctrl-single,pins = <
		P8_32( PIN_OUTPUT_PULLUP | INPUT_EN | MUX_MODE2) >; };	/* lcd_data15.eqep1_strobe */
	P8_32_lcd_pin: pinmux_P8_32_lcd_pin { pinctrl-single,pins = <
		P8_32( PIN_OUTPUT | MUX_MODE0) >; };	/* lcd_data15.lcd_data15 */

	/* P8_33 (ZCZ ball V3) hdmi */
	P8_33_default_pin: pinmux_P8_33_default_pin { pinctrl-single,pins = <
		P8_33( PIN_OUTPUT_PULLDOWN | INPUT_EN | MUX_MODE7) >; };	/* lcd_data13.gpio0_9 */
	P8_33_gpio_pin: pinmux_P8_33_gpio_pin { pinctrl-single,pins = <
		P8_33( PIN_OUTPUT | INPUT_EN | MUX_MODE7) >; };		/* lcd_data13.gpio0_9 */
	P8_33_gpio_pu_pin: pinmux_P8_33_gpio_pu_pin { pinctrl-single,pins = <
		P8_33( PIN_OUTPUT_PULLUP | INPUT_EN | MUX_MODE7) >; };	/* lcd_data13.gpio0_9 */
	P8_33_gpio_pd_pin: pinmux_P8_33_gpio_pd_pin { pinctrl-single,pins = <
		P8_33( PIN_OUTPUT_PULLDOWN | INPUT_EN | MUX_MODE7) >; };	/* lcd_data13.gpio0_9 */
	P8_33_eqep_pin: pinmux_P8_33_eqep_pin { pinctrl-single,pins = <
		P8_33( PIN_OUTPUT_PULLUP | INPUT_EN | MUX_MODE2) >; };	/* lcd_data13.eqep1b_in */
	P8_33_lcd_pin: pinmux_P8_33_lcd_pin { pinctrl-single,pins = <
		P8_33( PIN_OUTPUT | MUX_MODE0) >; };	/* lcd_data13.lcd_data13 */

	/* P8_34 (ZCZ ball U4) hdmi */
	P8_34_default_pin: pinmux_P8_34_default_pin { pinctrl-single,pins = <
		P8_34( PIN_OUTPUT_PULLDOWN | INPUT_EN | MUX_MODE7) >; };	/* lcd_data11.gpio2_17 */
	P8_34_gpio_pin: pinmux_P8_34_gpio_pin { pinctrl-single,pins = <
		P8_34( PIN_OUTPUT | INPUT_EN | MUX_MODE7) >; };		/* lcd_data11.gpio2_17 */
	P8_34_gpio_pu_pin: pinmux_P8_34_gpio_pu_pin { pinctrl-single,pins = <
		P8_34( PIN_OUTPUT_PULLUP | INPUT_EN | MUX_MODE7) >; };	/* lcd_data11.gpio2_17 */
	P8_34_gpio_pd_pin: pinmux_P8_34_gpio_pd_pin { pinctrl-single,pins = <
		P8_34( PIN_OUTPUT_PULLDOWN | INPUT_EN | MUX_MODE7) >; };	/* lcd_data11.gpio2_17 */
	P8_34_pwm_pin: pinmux_P8_34_pwm_pin { pinctrl-single,pins = <
		P8_34( PIN_OUTPUT_PULLDOWN | INPUT_EN | MUX_MODE2) >; };	/* lcd_data11.ehrpwm1b */
	P8_34_lcd_pin: pinmux_P8_34_lcd_pin { pinctrl-single,pins = <
		P8_34( PIN_OUTPUT | MUX_MODE0) >; };	/* lcd_data11.lcd_data11 */

	/* P8_35 (ZCZ ball V2) hdmi */
	P8_35_default_pin: pinmux_P8_35_default_pin { pinctrl-single,pins = <
		P8_35( PIN_OUTPUT_PULLDOWN | INPUT_EN | MUX_MODE7) >; };	/* lcd_data12.gpio0_8 */
	P8_35_gpio_pin: pinmux_P8_35_gpio_pin { pinctrl-single,pins = <
		P8_35( PIN_OUTPUT | INPUT_EN | MUX_MODE7) >; };		/* lcd_data12.gpio0_8 */
	P8_35_gpio_pu_pin: pinmux_P8_35_gpio_pu_pin { pinctrl-single,pins = <
		P8_35( PIN_OUTPUT_PULLUP | INPUT_EN | MUX_MODE7) >; };	/* lcd_data12.gpio0_8 */
	P8_35_gpio_pd_pin: pinmux_P8_35_gpio_pd_pin { pinctrl-single,pins = <
		P8_35( PIN_OUTPUT_PULLDOWN | INPUT_EN | MUX_MODE7) >; };	/* lcd_data12.gpio0_8 */
	P8_35_eqep_pin: pinmux_P8_35_eqep_pin { pinctrl-single,pins = <
		P8_35( PIN_OUTPUT_PULLUP | INPUT_EN | MUX_MODE2) >; };	/* lcd_data12.eqep1a_in */
	P8_35_lcd_pin: pinmux_P8_35_lcd_pin { pinctrl-single,pins = <
		P8_35( PIN_OUTPUT | MUX_MODE0) >; };	/* lcd_data12.eqep1a_in */

	/* P8_36 (ZCZ ball U3) hdmi */
	P8_36_default_pin: pinmux_P8_36_default_pin { pinctrl-single,pins = <
		P8_36( PIN_OUTPUT_PULLDOWN | INPUT_EN | MUX_MODE7) >; };	/* lcd_data10.gpio2_16 */
	P8_36_gpio_pin: pinmux_P8_36_gpio_pin { pinctrl-single,pins = <
		P8_36( PIN_OUTPUT | INPUT_EN | MUX_MODE7) >; };		/* lcd_data10.gpio2_16 */
	P8_36_gpio_pu_pin: pinmux_P8_36_gpio_pu_pin { pinctrl-single,pins = <
		P8_36( PIN_OUTPUT_PULLUP | INPUT_EN | MUX_MODE7) >; };	/* lcd_data10.gpio2_16 */
	P8_36_gpio_pd_pin: pinmux_P8_36_gpio_pd_pin { pinctrl-single,pins = <
		P8_36( PIN_OUTPUT_PULLDOWN | INPUT_EN | MUX_MODE7) >; };	/* lcd_data10.gpio2_16 */
	P8_36_pwm_pin: pinmux_P8_36_pwm_pin { pinctrl-single,pins = <
		P8_36( PIN_OUTPUT_PULLDOWN | INPUT_EN | MUX_MODE2) >; };	/* lcd_data10.ehrpwm1a */
	P8_36_lcd_pin: pinmux_P8_36_lcd_pin { pinctrl-single,pins = <
		P8_36( PIN_OUTPUT | MUX_MODE0) >; };	/* lcd_data10.lcd_data10 */

	/* P8_37 (ZCZ ball U1) hdmi */
	P8_37_default_pin: pinmux_P8_37_default_pin { pinctrl-single,pins = <
		P8_37( PIN_OUTPUT_PULLDOWN | INPUT_EN | MUX_MODE7) >; };	/* lcd_data8.gpio2_14 */
	P8_37_gpio_pin: pinmux_P8_37_gpio_pin { pinctrl-single,pins = <
		P8_37( PIN_OUTPUT | INPUT_EN | MUX_MODE7) >; };		/* lcd_data8.gpio2_14 */
	P8_37_gpio_pu_pin: pinmux_P8_37_gpio_pu_pin { pinctrl-single,pins = <
		P8_37( PIN_OUTPUT_PULLUP | INPUT_EN | MUX_MODE7) >; };	/* lcd_data8.gpio2_14 */
	P8_37_gpio_pd_pin: pinmux_P8_37_gpio_pd_pin { pinctrl-single,pins = <
		P8_37( PIN_OUTPUT_PULLDOWN | INPUT_EN | MUX_MODE7) >; };	/* lcd_data8.gpio2_14 */
	P8_37_pwm_pin: pinmux_P8_37_pwm_pin { pinctrl-single,pins = <
		P8_37( PIN_OUTPUT_PULLDOWN | INPUT_EN | MUX_MODE2) >; };	/* lcd_data8.ehrpwm1_tripzone_input */
	P8_37_uart_pin: pinmux_P8_37_uart_pin { pinctrl-single,pins = <
		P8_37( PIN_OUTPUT_PULLUP | INPUT_EN | MUX_MODE4) >; };	/* lcd_data8.uart5_txd */
	P8_37_lcd_pin: pinmux_P8_37_lcd_pin { pinctrl-single,pins = <
		P8_37( PIN_OUTPUT | MUX_MODE0) >; };	/* lcd_data8.lcd_data8 */

	/* P8_38 (ZCZ ball U2) hdmi */
	P8_38_default_pin: pinmux_P8_38_default_pin { pinctrl-single,pins = <
		P8_38( PIN_OUTPUT_PULLDOWN | INPUT_EN | MUX_MODE7) >; };	/* lcd_data9.gpio2_15 */
	P8_38_gpio_pin: pinmux_P8_38_gpio_pin { pinctrl-single,pins = <
		P8_38( PIN_OUTPUT | INPUT_EN | MUX_MODE7) >; };		/* lcd_data9.gpio2_15 */
	P8_38_gpio_pu_pin: pinmux_P8_38_gpio_pu_pin { pinctrl-single,pins = <
		P8_38( PIN_OUTPUT_PULLUP | INPUT_EN | MUX_MODE7) >; };	/* lcd_data9.gpio2_15 */
	P8_38_gpio_pd_pin: pinmux_P8_38_gpio_pd_pin { pinctrl-single,pins = <
		P8_38( PIN_OUTPUT_PULLDOWN | INPUT_EN | MUX_MODE7) >; };	/* lcd_data9.gpio2_15 */
	P8_38_pwm_pin: pinmux_P8_38_pwm_pin { pinctrl-single,pins = <
		P8_38( PIN_OUTPUT_PULLDOWN | INPUT_EN | MUX_MODE2) >; };	/* lcd_data9.ehrpwm0_synco */
	P8_38_uart_pin: pinmux_P8_38_uart_pin { pinctrl-single,pins = <
		P8_38( PIN_OUTPUT_PULLUP | INPUT_EN | MUX_MODE4) >; };	/* lcd_data9.uart5_rxd */
	P8_38_lcd_pin: pinmux_P8_38_lcd_pin { pinctrl-single,pins = <
		P8_38( PIN_OUTPUT | MUX_MODE0) >; };	/* lcd_data9.lcd_data9 */

	/* P8_39 (ZCZ ball T3) hdmi */
	P8_39_default_pin: pinmux_P8_39_default_pin { pinctrl-single,pins = <
		P8_39( PIN_OUTPUT_PULLDOWN | INPUT_EN | MUX_MODE7) >; };	/* lcd_data6.gpio2_12 */
	P8_39_gpio_pin: pinmux_P8_39_gpio_pin { pinctrl-single,pins = <
		P8_39( PIN_OUTPUT | INPUT_EN | MUX_MODE7) >; };		/* lcd_data6.gpio2_12 */
	P8_39_gpio_pu_pin: pinmux_P8_39_gpio_pu_pin { pinctrl-single,pins = <
		P8_39( PIN_OUTPUT_PULLUP | INPUT_EN | MUX_MODE7) >; };	/* lcd_data6.gpio2_12 */
	P8_39_gpio_pd_pin: pinmux_P8_39_gpio_pd_pin { pinctrl-single,pins = <
		P8_39( PIN_OUTPUT_PULLDOWN | INPUT_EN | MUX_MODE7) >; };	/* lcd_data6.gpio2_12 */
	P8_39_eqep_pin: pinmux_P8_39_eqep_pin { pinctrl-single,pins = <
		P8_39( PIN_OUTPUT_PULLUP | INPUT_EN | MUX_MODE3) >; };	/* lcd_data6.eqep2_index */
	P8_39_pruout_pin: pinmux_P8_39_pruout_pin { pinctrl-single,pins = <
		P8_39( PIN_OUTPUT_PULLDOWN | INPUT_EN | MUX_MODE5) >; };	/* lcd_data6.pru1_out6 */
	P8_39_pruin_pin: pinmux_P8_39_pruin_pin { pinctrl-single,pins = <
		P8_39( PIN_INPUT | MUX_MODE6) >; };			/* lcd_data6.pru1_in6 */
	P8_39_lcd_pin: pinmux_P8_39_lcd_pin { pinctrl-single,pins = <
		P8_39( PIN_OUTPUT | MUX_MODE0) >; };	/* lcd_data6.lcd_data6 */

	/* P8_40 (ZCZ ball T4) hdmi */
	P8_40_default_pin: pinmux_P8_40_default_pin { pinctrl-single,pins = <
		P8_40( PIN_OUTPUT_PULLDOWN | INPUT_EN | MUX_MODE7) >; };	/* lcd_data7.gpio2_13 */
	P8_40_gpio_pin: pinmux_P8_40_gpio_pin { pinctrl-single,pins = <
		P8_40( PIN_OUTPUT | INPUT_EN | MUX_MODE7) >; };		/* lcd_data7.gpio2_13 */
	P8_40_gpio_pu_pin: pinmux_P8_40_gpio_pu_pin { pinctrl-single,pins = <
		P8_40( PIN_OUTPUT_PULLUP | INPUT_EN | MUX_MODE7) >; };	/* lcd_data7.gpio2_13 */
	P8_40_gpio_pd_pin: pinmux_P8_40_gpio_pd_pin { pinctrl-single,pins = <
		P8_40( PIN_OUTPUT_PULLDOWN | INPUT_EN | MUX_MODE7) >; };	/* lcd_data7.gpio2_13 */
	P8_40_eqep_pin: pinmux_P8_40_eqep_pin { pinctrl-single,pins = <
		P8_40( PIN_OUTPUT_PULLUP | INPUT_EN | MUX_MODE3) >; };	/* lcd_data7.eqep2_strobe */
	P8_40_pruout_pin: pinmux_P8_40_pruout_pin { pinctrl-single,pins = <
		P8_40( PIN_OUTPUT_PULLDOWN | INPUT_EN | MUX_MODE5) >; };	/* lcd_data7.pru1_out7 */
	P8_40_pruin_pin: pinmux_P8_40_pruin_pin { pinctrl-single,pins = <
		P8_40( PIN_INPUT | MUX_MODE6) >; };			/* lcd_data7.pru1_in7 */
	P8_40_lcd_pin: pinmux_P8_40_lcd_pin { pinctrl-single,pins = <
		P8_40( PIN_OUTPUT | MUX_MODE0) >; };	/* lcd_data7.lcd_data7 */

	/* P8_41 (ZCZ ball T1) hdmi */
	P8_41_default_pin: pinmux_P8_41_default_pin { pinctrl-single,pins = <
		P8_41( PIN_OUTPUT_PULLDOWN | INPUT_EN | MUX_MODE7) >; };	/* lcd_data4.gpio2_10 */
	P8_41_gpio_pin: pinmux_P8_41_gpio_pin { pinctrl-single,pins = <
		P8_41( PIN_OUTPUT | INPUT_EN | MUX_MODE7) >; };		/* lcd_data4.gpio2_10 */
	P8_41_gpio_pu_pin: pinmux_P8_41_gpio_pu_pin { pinctrl-single,pins = <
		P8_41( PIN_OUTPUT_PULLUP | INPUT_EN | MUX_MODE7) >; };	/* lcd_data4.gpio2_10 */
	P8_41_gpio_pd_pin: pinmux_P8_41_gpio_pd_pin { pinctrl-single,pins = <
		P8_41( PIN_OUTPUT_PULLDOWN | INPUT_EN | MUX_MODE7) >; };	/* lcd_data4.gpio2_10 */
	P8_41_eqep_pin: pinmux_P8_41_eqep_pin { pinctrl-single,pins = <
		P8_41( PIN_OUTPUT_PULLUP | INPUT_EN | MUX_MODE3) >; };	/* lcd_data4.eqep2a_in */
	P8_41_pruout_pin: pinmux_P8_41_pruout_pin { pinctrl-single,pins = <
		P8_41( PIN_OUTPUT_PULLDOWN | INPUT_EN | MUX_MODE5) >; };	/* lcd_data4.pru1_out4 */
	P8_41_pruin_pin: pinmux_P8_41_pruin_pin { pinctrl-single,pins = <
		P8_41( PIN_INPUT | MUX_MODE6) >; };			/* lcd_data4.pru1_in4 */
	P8_41_lcd_pin: pinmux_P8_41_lcd_pin { pinctrl-single,pins = <
		P8_41( PIN_OUTPUT | MUX_MODE0) >; };			/* lcd_data4.lcd_data4 */

	/* P8_42 (ZCZ ball T2) hdmi */
	P8_42_default_pin: pinmux_P8_42_default_pin { pinctrl-single,pins = <
		P8_42( PIN_OUTPUT_PULLDOWN | INPUT_EN | MUX_MODE7) >; };	/* lcd_data5.gpio2_11 */
	P8_42_gpio_pin: pinmux_P8_42_gpio_pin { pinctrl-single,pins = <
		P8_42( PIN_OUTPUT | INPUT_EN | MUX_MODE7) >; };		/* lcd_data5.gpio2_11 */
	P8_42_gpio_pu_pin: pinmux_P8_42_gpio_pu_pin { pinctrl-single,pins = <
		P8_42( PIN_OUTPUT_PULLUP | INPUT_EN | MUX_MODE7) >; };	/* lcd_data5.gpio2_11 */
	P8_42_gpio_pd_pin: pinmux_P8_42_gpio_pd_pin { pinctrl-single,pins = <
		P8_42( PIN_OUTPUT_PULLDOWN | INPUT_EN | MUX_MODE7) >; };	/* lcd_data5.gpio2_11 */
	P8_42_eqep_pin: pinmux_P8_42_eqep_pin { pinctrl-single,pins = <
		P8_42( PIN_OUTPUT_PULLUP | INPUT_EN | MUX_MODE3) >; };	/* lcd_data5.eqep2b_in */
	P8_42_pruout_pin: pinmux_P8_42_pruout_pin { pinctrl-single,pins = <
		P8_42( PIN_OUTPUT_PULLDOWN | INPUT_EN | MUX_MODE5) >; };	/* lcd_data5.pru1_out5 */
	P8_42_pruin_pin: pinmux_P8_42_pruin_pin { pinctrl-single,pins = <
		P8_42( PIN_INPUT | MUX_MODE6) >; };			/* lcd_data5.pru1_in5 */
	P8_42_lcd_pin: pinmux_P8_42_lcd_pin { pinctrl-single,pins = <
		P8_42( PIN_OUTPUT | MUX_MODE0) >; };			/* lcd_data5.lcd_data5 */

	/* P8_43 (ZCZ ball R3) hdmi */
	P8_43_default_pin: pinmux_P8_43_default_pin { pinctrl-single,pins = <
		P8_43( PIN_OUTPUT_PULLDOWN | INPUT_EN | MUX_MODE7) >; };	/* lcd_data2.gpio2_8 */
	P8_43_gpio_pin: pinmux_P8_43_gpio_pin { pinctrl-single,pins = <
		P8_43( PIN_OUTPUT | INPUT_EN | MUX_MODE7) >; };		/* lcd_data2.gpio2_8 */
	P8_43_gpio_pu_pin: pinmux_P8_43_gpio_pu_pin { pinctrl-single,pins = <
		P8_43( PIN_OUTPUT_PULLUP | INPUT_EN | MUX_MODE7) >; };	/* lcd_data2.gpio2_8 */
	P8_43_gpio_pd_pin: pinmux_P8_43_gpio_pd_pin { pinctrl-single,pins = <
		P8_43( PIN_OUTPUT_PULLDOWN | INPUT_EN | MUX_MODE7) >; };	/* lcd_data2.gpio2_8 */
	P8_43_pwm_pin: pinmux_P8_43_pwm_pin { pinctrl-single,pins = <
		P8_43( PIN_OUTPUT_PULLDOWN | INPUT_EN | MUX_MODE3) >; };	/* lcd_data2.ehrpwm2_tripzone_input */
	P8_43_pruout_pin: pinmux_P8_43_pruout_pin { pinctrl-single,pins = <
		P8_43( PIN_OUTPUT_PULLDOWN | INPUT_EN | MUX_MODE5) >; };	/* lcd_data2.pru1_out2 */
	P8_43_pruin_pin: pinmux_P8_43_pruin_pin { pinctrl-single,pins = <
		P8_43( PIN_INPUT | MUX_MODE6) >; };			/* lcd_data2.pru1_in2 */
	P8_43_lcd_pin: pinmux_P8_43_lcd_pin { pinctrl-single,pins = <
		P8_43( PIN_OUTPUT | MUX_MODE0) >; };			/* lcd_data2.lcd_data2 */

	/* P8_44 (ZCZ ball R4) hdmi */
	P8_44_default_pin: pinmux_P8_44_default_pin { pinctrl-single,pins = <
		P8_44( PIN_OUTPUT_PULLDOWN | INPUT_EN | MUX_MODE7) >; };	/* lcd_data3.gpio2_9 */
	P8_44_gpio_pin: pinmux_P8_44_gpio_pin { pinctrl-single,pins = <
		P8_44( PIN_OUTPUT | INPUT_EN | MUX_MODE7) >; };		/* lcd_data3.gpio2_9 */
	P8_44_gpio_pu_pin: pinmux_P8_44_gpio_pu_pin { pinctrl-single,pins = <
		P8_44( PIN_OUTPUT_PULLUP | INPUT_EN | MUX_MODE7) >; };	/* lcd_data3.gpio2_9 */
	P8_44_gpio_pd_pin: pinmux_P8_44_gpio_pd_pin { pinctrl-single,pins = <
		P8_44( PIN_OUTPUT_PULLDOWN | INPUT_EN | MUX_MODE7) >; };	/* lcd_data3.gpio2_9 */
	P8_44_pwm_pin: pinmux_P8_44_pwm_pin { pinctrl-single,pins = <
		P8_44( PIN_OUTPUT_PULLDOWN | INPUT_EN | MUX_MODE3) >; };	/* lcd_data3.ehrpwm0_synco */
	P8_44_pruout_pin: pinmux_P8_44_pruout_pin { pinctrl-single,pins = <
		P8_44( PIN_OUTPUT_PULLDOWN | INPUT_EN | MUX_MODE5) >; };	/* lcd_data3.pru1_out3 */
	P8_44_pruin_pin: pinmux_P8_44_pruin_pin { pinctrl-single,pins = <
		P8_44( PIN_INPUT | MUX_MODE6) >; };			/* lcd_data3.pru1_in3 */
	P8_44_lcd_pin: pinmux_P8_44_lcd_pin { pinctrl-single,pins = <
		P8_44( PIN_OUTPUT | MUX_MODE0) >; };			/* lcd_data3.lcd_data3 */

	/* P8_45 (ZCZ ball R1) hdmi */
	P8_45_default_pin: pinmux_P8_45_default_pin { pinctrl-single,pins = <
		P8_45( PIN_OUTPUT_PULLDOWN | INPUT_EN | MUX_MODE7) >; };	/* lcd_data0.gpio2_6 */
	P8_45_gpio_pin: pinmux_P8_45_gpio_pin { pinctrl-single,pins = <
		P8_45( PIN_OUTPUT | INPUT_EN | MUX_MODE7) >; };		/* lcd_data0.gpio2_6 */
	P8_45_gpio_pu_pin: pinmux_P8_45_gpio_pu_pin { pinctrl-single,pins = <
		P8_45( PIN_OUTPUT_PULLUP | INPUT_EN | MUX_MODE7) >; };	/* lcd_data0.gpio2_6 */
	P8_45_gpio_pd_pin: pinmux_P8_45_gpio_pd_pin { pinctrl-single,pins = <
		P8_45( PIN_OUTPUT_PULLDOWN | INPUT_EN | MUX_MODE7) >; };	/* lcd_data0.gpio2_6 */
	P8_45_pwm_pin: pinmux_P8_45_pwm_pin { pinctrl-single,pins = <
		P8_45( PIN_OUTPUT_PULLDOWN | INPUT_EN | MUX_MODE3) >; };	/* lcd_data0.ehrpwm2a */
	P8_45_pruout_pin: pinmux_P8_45_pruout_pin { pinctrl-single,pins = <
		P8_45( PIN_OUTPUT_PULLDOWN | INPUT_EN | MUX_MODE5) >; };	/* lcd_data0.pru1_out0 */
	P8_45_pruin_pin: pinmux_P8_45_pruin_pin { pinctrl-single,pins = <
		P8_45( PIN_INPUT | MUX_MODE6) >; };			/* lcd_data0.pru1_in0 */
	P8_45_lcd_pin: pinmux_P8_45_lcd_pin { pinctrl-single,pins = <
		P8_45( PIN_OUTPUT | MUX_MODE0) >; };			/* lcd_data0.lcd_data0 */

	/* P8_46 (ZCZ ball R2) hdmi */
	P8_46_default_pin: pinmux_P8_46_default_pin { pinctrl-single,pins = <
		P8_46( PIN_OUTPUT_PULLDOWN | INPUT_EN | MUX_MODE7) >; };	/* lcd_data1.gpio2_7 */
	P8_46_gpio_pin: pinmux_P8_46_gpio_pin { pinctrl-single,pins = <
		P8_46( PIN_OUTPUT | INPUT_EN | MUX_MODE7) >; };		/* lcd_data1.gpio2_7 */
	P8_46_gpio_pu_pin: pinmux_P8_46_gpio_pu_pin { pinctrl-single,pins = <
		P8_46( PIN_OUTPUT_PULLUP | INPUT_EN | MUX_MODE7) >; };	/* lcd_data1.gpio2_7 */
	P8_46_gpio_pd_pin: pinmux_P8_46_gpio_pd_pin { pinctrl-single,pins = <
		P8_46( PIN_OUTPUT_PULLDOWN | INPUT_EN | MUX_MODE7) >; };	/* lcd_data1.gpio2_7 */
	P8_46_pwm_pin: pinmux_P8_46_pwm_pin { pinctrl-single,pins = <
		P8_46( PIN_OUTPUT_PULLDOWN | INPUT_EN | MUX_MODE3) >; };	/* lcd_data1.ehrpwm2b */
	P8_46_pruout_pin: pinmux_P8_46_pruout_pin { pinctrl-single,pins = <
		P8_46( PIN_OUTPUT_PULLDOWN | INPUT_EN | MUX_MODE5) >; };	/* lcd_data1.pru1_out1 */
	P8_46_pruin_pin: pinmux_P8_46_pruin_pin { pinctrl-single,pins = <
		P8_46( PIN_INPUT | MUX_MODE6) >; };			/* lcd_data1.pru1_in1 */
	P8_46_lcd_pin: pinmux_P8_46_lcd_pin { pinctrl-single,pins = <
		P8_46( PIN_OUTPUT | MUX_MODE0) >; };			/* lcd_data1.lcd_data1 */

	/************************/
	/* P9 Header */
	/************************/

	/* P9_01                GND */

	/* P9_02                GND */

	/* P9_03                3V3 */

	/* P9_04                3V3 */

	/* P9_05                VDD_5V */

	/* P9_06                VDD_5V */

	/* P9_07                SYS_5V */

	/* P9_08                SYS_5V */

	/* P9_09                PWR_BUT */

	/* P9_10                RSTn */

	/* P9_11 (ZCZ ball T17) gpio0_30 */
	P9_11_default_pin: pinmux_P9_11_default_pin { pinctrl-single,pins = <
		P9_11( PIN_OUTPUT_PULLUP | INPUT_EN | MUX_MODE7) >; };	/* gpmc_wait0.gpio0_30 */
	P9_11_gpio_pin: pinmux_P9_11_gpio_pin { pinctrl-single,pins = <
		P9_11( PIN_OUTPUT | INPUT_EN | MUX_MODE7) >; };		/* gpmc_wait0.gpio0_30 */
	P9_11_gpio_pu_pin: pinmux_P9_11_gpio_pu_pin { pinctrl-single,pins = <
		P9_11( PIN_OUTPUT_PULLUP | INPUT_EN | MUX_MODE7) >; };	/* gpmc_wait0.gpio0_30 */
	P9_11_gpio_pd_pin: pinmux_P9_11_gpio_pd_pin { pinctrl-single,pins = <
		P9_11( PIN_OUTPUT_PULLDOWN | INPUT_EN | MUX_MODE7) >; };	/* gpmc_wait0.gpio0_30 */
	P9_11_uart_pin: pinmux_P9_11_uart_pin { pinctrl-single,pins = <
		P9_11( PIN_OUTPUT_PULLUP | INPUT_EN | MUX_MODE6) >; };	/* gpmc_wait0.uart4_rxd */

	/* P9_12 (ZCZ ball U18) gpio1_28 */
	P9_12_default_pin: pinmux_P9_12_default_pin { pinctrl-single,pins = <
		P9_12( PIN_OUTPUT_PULLUP | INPUT_EN | MUX_MODE7) >; };	/* gpmc_be1n.gpio1_28 */
	P9_12_gpio_pin: pinmux_P9_12_gpio_pin { pinctrl-single,pins = <
		P9_12( PIN_OUTPUT | INPUT_EN | MUX_MODE7) >; };		/* gpmc_be1n.gpio1_28 */
	P9_12_gpio_pu_pin: pinmux_P9_12_gpio_pu_pin { pinctrl-single,pins = <
		P9_12( PIN_OUTPUT_PULLUP | INPUT_EN | MUX_MODE7) >; };	/* gpmc_be1n.gpio1_28 */
	P9_12_gpio_pd_pin: pinmux_P9_12_gpio_pd_pin { pinctrl-single,pins = <
		P9_12( PIN_OUTPUT_PULLDOWN | INPUT_EN | MUX_MODE7) >; };	/* gpmc_be1n.gpio1_28 */
	P9_12_mcasp_pin: pinmux_P9_12_mcasp_pin { pinctrl-single,pins = <
		P9_12( PIN_INPUT_PULLDOWN | MUX_MODE6) >; };			/* gpmc_be1n.mcasp0_aclkr */

	/* P9_13 (ZCZ ball U17) gpio0_31 */
	P9_13_default_pin: pinmux_P9_13_default_pin { pinctrl-single,pins = <
		P9_13( PIN_OUTPUT_PULLUP | INPUT_EN | MUX_MODE7) >; };	/* gpmc_wpn.gpio0_31 */
	P9_13_gpio_pin: pinmux_P9_13_gpio_pin { pinctrl-single,pins = <
		P9_13( PIN_OUTPUT | INPUT_EN | MUX_MODE7) >; };		/* gpmc_wpn.gpio0_31 */
	P9_13_gpio_pu_pin: pinmux_P9_13_gpio_pu_pin { pinctrl-single,pins = <
		P9_13( PIN_OUTPUT_PULLUP | INPUT_EN | MUX_MODE7) >; };	/* gpmc_wpn.gpio0_31 */
	P9_13_gpio_pd_pin: pinmux_P9_13_gpio_pd_pin { pinctrl-single,pins = <
		P9_13( PIN_OUTPUT_PULLDOWN | INPUT_EN | MUX_MODE7) >; };	/* gpmc_wpn.gpio0_31 */
	P9_13_uart_pin: pinmux_P9_13_uart_pin { pinctrl-single,pins = <
		P9_13( PIN_OUTPUT_PULLUP | INPUT_EN | MUX_MODE6) >; };	/* gpmc_wpn.uart4_txd */

	/* P9_14 (ZCZ ball U14) gpio1_18 */

	/* P9_15 (ZCZ ball R13) gpio1_16 */
	P9_15_default_pin: pinmux_P9_15_default_pin { pinctrl-single,pins = <
		P9_15( PIN_OUTPUT_PULLDOWN | INPUT_EN | MUX_MODE7) >; };	/* gpmc_a0.gpio1_16 */
	P9_15_gpio_pin: pinmux_P9_15_gpio_pin { pinctrl-single,pins = <
		P9_15( PIN_OUTPUT | INPUT_EN | MUX_MODE7) >; };		/* gpmc_a0.gpio1_16 */
	P9_15_gpio_pu_pin: pinmux_P9_15_gpio_pu_pin { pinctrl-single,pins = <
		P9_15( PIN_OUTPUT_PULLUP | INPUT_EN | MUX_MODE7) >; };	/* gpmc_a0.gpio1_16 */
	P9_15_gpio_pd_pin: pinmux_P9_15_gpio_pd_pin { pinctrl-single,pins = <
		P9_15( PIN_OUTPUT_PULLDOWN | INPUT_EN | MUX_MODE7) >; };	/* gpmc_a0.gpio1_16 */
	P9_15_pwm_pin: pinmux_P9_15_pwm_pin { pinctrl-single,pins = <
		P9_15( PIN_OUTPUT_PULLDOWN | INPUT_EN | MUX_MODE6) >; };	/* gpmc_a0.ehrpwm1_tripzone_input */

	/* P9_15 dummy nodes for unavailable bone bus pins*/
	P9_15_eqep_pin: pinmux_P9_15_eqep_pin { pinctrl-single,pins = <
		/* To avoid FDT_ERROR on BBBWL/BBB when using BONE-EQEP2.dtbo */
		/* Default pinmux configuration of P9_15 (P9_15_default_pin) */
		P9_15( PIN_OUTPUT_PULLDOWN | INPUT_EN | MUX_MODE7) >; };	/* gpmc_a0.gpio1_16 */

	/* P9_16 (ZCZ ball T14) gpio1_19 */
	P9_16_default_pin: pinmux_P9_16_default_pin { pinctrl-single,pins = <
		P9_16( PIN_OUTPUT_PULLDOWN | INPUT_EN | MUX_MODE7) >; };	/* gpmc_a3.gpio1_19 */
	P9_16_gpio_pin: pinmux_P9_16_gpio_pin { pinctrl-single,pins = <
		P9_16( PIN_OUTPUT | INPUT_EN | MUX_MODE7) >; };		/* gpmc_a3.gpio1_19 */
	P9_16_gpio_pu_pin: pinmux_P9_16_gpio_pu_pin { pinctrl-single,pins = <
		P9_16( PIN_OUTPUT_PULLUP | INPUT_EN | MUX_MODE7) >; };	/* gpmc_a3.gpio1_19 */
	P9_16_gpio_pd_pin: pinmux_P9_16_gpio_pd_pin { pinctrl-single,pins = <
		P9_16( PIN_OUTPUT_PULLDOWN | INPUT_EN | MUX_MODE7) >; };	/* gpmc_a3.gpio1_19 */
	P9_16_pwm_pin: pinmux_P9_16_pwm_pin { pinctrl-single,pins = <
		P9_16( PIN_OUTPUT_PULLDOWN | INPUT_EN | MUX_MODE6) >; };	/* gpmc_a3.ehrpwm1b */

	/* P9_17 (ZCZ ball A16) gpio0_5 */

	/* P9_18 (ZCZ ball B16) gpio0_4 */

	/* P9_19 (ZCZ ball D17) i2c2_scl */

	/* P9_20 (ZCZ ball D18) i2c2_sda */

	/* P9_21 (ZCZ ball B17) gpio0_3 */

	/* P9_21 dummy nodes for unavailable bone bus pins*/

	/* P9_22 (ZCZ ball A17) gpio0_2 */

	/* P9_22 dummy nodes for unavailable bone bus */

	/* P9_23 (ZCZ ball V14) gpio1_17 */
	P9_23_default_pin: pinmux_P9_23_default_pin { pinctrl-single,pins = <
		P9_23( PIN_OUTPUT_PULLDOWN | INPUT_EN | MUX_MODE7) >; };	/* gpmc_a1.gpio1_17 */
	P9_23_gpio_pin: pinmux_P9_23_gpio_pin { pinctrl-single,pins = <
		P9_23( PIN_OUTPUT | INPUT_EN | MUX_MODE7) >; };		/* gpmc_a1.gpio1_17 */
	P9_23_gpio_pu_pin: pinmux_P9_23_gpio_pu_pin { pinctrl-single,pins = <
		P9_23( PIN_OUTPUT_PULLUP | INPUT_EN | MUX_MODE7) >; };	/* gpmc_a1.gpio1_17 */
	P9_23_gpio_pd_pin: pinmux_P9_23_gpio_pd_pin { pinctrl-single,pins = <
		P9_23( PIN_OUTPUT_PULLDOWN | INPUT_EN | MUX_MODE7) >; };	/* gpmc_a1.gpio1_17 */
	P9_23_pwm_pin: pinmux_P9_23_pwm_pin { pinctrl-single,pins = <
		P9_23( PIN_OUTPUT_PULLDOWN | INPUT_EN | MUX_MODE6) >; };	/* gpmc_a1.ehrpwm0_synco */

	/* P9_24 (ZCZ ball D15) gpio0_15 */

	/* P9_25 (ZCZ ball A14) audio */

	/* P9_26 (ZCZ ball D16) gpio0_14 */

	/* P9_27 (ZCZ ball C13) gpio3_19 */

	/* P9_28 (ZCZ ball C12) audio */
	P9_28_default_pin: pinmux_P9_28_default_pin { pinctrl-single,pins = <
		P9_28( PIN_OUTPUT_PULLDOWN | INPUT_EN | MUX_MODE7) >; };	/* mcasp0_ahclkr.gpio3_17 */
	P9_28_gpio_pin: pinmux_P9_28_gpio_pin { pinctrl-single,pins = <
		P9_28( PIN_OUTPUT | INPUT_EN | MUX_MODE7) >; };		/* mcasp0_ahclkr.gpio3_17 */
	P9_28_gpio_pu_pin: pinmux_P9_28_gpio_pu_pin { pinctrl-single,pins = <
		P9_28( PIN_OUTPUT_PULLUP | INPUT_EN | MUX_MODE7) >; };	/* mcasp0_ahclkr.gpio3_17 */
	P9_28_gpio_pd_pin: pinmux_P9_28_gpio_pd_pin { pinctrl-single,pins = <
		P9_28( PIN_OUTPUT_PULLDOWN | INPUT_EN | MUX_MODE7) >; };	/* mcasp0_ahclkr.gpio3_17 */
	P9_28_pwm_pin: pinmux_P9_28_pwm_pin { pinctrl-single,pins = <
		P9_28( PIN_OUTPUT_PULLDOWN | INPUT_EN | MUX_MODE1) >; };	/* mcasp0_ahclkr.ehrpwm0_synci */
	P9_28_spi_cs_pin: pinmux_P9_28_spi_cs_pin { pinctrl-single,pins = <
		P9_28( PIN_OUTPUT_PULLUP | INPUT_EN | MUX_MODE3) >; };	/* mcasp0_ahclkr.spi1_cs0 */
	P9_28_ecap_pwm_pin: pinmux_P9_28_ecap_pwm_pin { pinctrl-single,pins = <
		P9_28( PIN_OUTPUT_PULLDOWN | INPUT_EN | MUX_MODE4) >; };	/* mcasp0_ahclkr.ecap2_in_pwm2_out */
	P9_28_pruout_pin: pinmux_P9_28_pruout_pin { pinctrl-single,pins = <
		P9_28( PIN_OUTPUT_PULLDOWN | INPUT_EN | MUX_MODE5) >; };	/* mcasp0_ahclkr.pru0_out3 */
	P9_28_pruin_pin: pinmux_P9_28_pruin_pin { pinctrl-single,pins = <
		P9_28( PIN_INPUT | MUX_MODE6) >; };			/* mcasp0_ahclkr.pru0_in3 */
	P9_28_mcasp_pin: pinmux_P9_28_mcasp_pin { pinctrl-single,pins = <
		P9_28( PIN_INPUT_PULLDOWN | MUX_MODE2) >; };			/* mcasp0_ahclkr.mcasp0_axr2 */

	/* P9_29 (ZCZ ball B13) audio */

	/* P9_30 (ZCZ ball D12) gpio3_16 */

	/* P9_31 (ZCZ ball A13) audio */

	/* P9_32                VADC */

	/* P9_33 (ZCZ ball C8)  AIN4         */

	/* P9_34                AGND */

	/* P9_35 (ZCZ ball A8)  AIN6         */

	/* P9_36 (ZCZ ball B8)  AIN5         */

	/* P9_37 (ZCZ ball B7)  AIN2         */

	/* P9_38 (ZCZ ball A7)  AIN3         */

	/* P9_39 (ZCZ ball B6)  AIN0         */

	/* P9_40 (ZCZ ball C7)  AIN1         */

	/* P9_41 (ZCZ ball D14) gpio0_20 */

	/* P9_41.1 */
	/* P9_91 (ZCZ ball D13) gpio3_20 */

	/* P9_42 (ZCZ ball C18) gpio0_7 */

	/* P9_42.1 */
	/* P9_92 (ZCZ ball B12) gpio3_18 */

	/* P9_43                GND */

	/* P9_44                GND */

	/* P9_45                GND */

	/* P9_46                GND */

	/*       (ZCZ ball A15) */
	A15_default_pin: pinmux_A15_default_pin {
		pinctrl-single,pins = <0x1b0  (PIN_OUTPUT_PULLUP | MUX_MODE7)>; };     /* Mode 7, Pull-Up */
	A15_clkout_pin: pinmux_A15_clkout_pin {
		pinctrl-single,pins = <0x1b0  0x0b>; };     /* Mode 3 */
	A15_gpio_pin: pinmux_A15_gpio_pin {
		pinctrl-single,pins = <0x1b0  0x2f>; };     /* Mode 7, RxActive */
	A15_gpio_pu_pin: pinmux_A15_gpio_pu_pin {
		pinctrl-single,pins = <0x1b0  0x37>; };     /* Mode 7, Pull-Up, RxActive */
	A15_gpio_pd_pin: pinmux_A15_gpio_pd_pin {
		pinctrl-single,pins = <0x1b0  0x27>; };     /* Mode 7, Pull-Down, RxActive */
};

&uart1 {
	status = "okay";
	pinctrl-names = "default";
	pinctrl-0 = <>;
	symlink = "bone/uart/1";
};

&uart2 {
	status = "okay";
	pinctrl-names = "default";
	pinctrl-0 = <>;
	symlink = "bone/uart/2";
};

&uart3 {
	status = "okay";
	pinctrl-names = "default";
	pinctrl-0 = <>;
	symlink = "bone/uart/3";
};

&uart4 {
	status = "okay";
	pinctrl-names = "default";
	pinctrl-0 = <>;
	symlink = "bone/uart/4";
};

&uart5 {
	status = "okay";
	pinctrl-names = "default";
	pinctrl-0 = <>;
	symlink = "bone/uart/5";
};

&dcan0 {
	status = "okay";
	pinctrl-names = "default";
	pinctrl-0 = <>;
	symlink = "bone/can/0";
};

&dcan1 {
	status = "okay";
	pinctrl-names = "default";
	pinctrl-0 = <>;
	symlink = "bone/can/1";
};

&eqep0 {
	status = "okay";
	pinctrl-names = "default";
	pinctrl-0 = <>;

	count_mode = <0>; /* 0 - Quadrature mode, normal 90 phase offset cha & chb. 1 - Direction mode. cha input = clock, chb input = direction */
	swap_inputs = <0>; /* Are channel A and channel B swapped? (0 - no, 1 - yes) */
	invert_qa = <1>; /* Should we invert the channel A input? */
	invert_qb = <1>; /* Should we invert the channel B input? I invert these because my encoder outputs drive transistors that pull down the pins */
	invert_qi = <0>; /* Should we invert the index input? */
	invert_qs = <0>; /* Should we invert the strobe input? */
	symlink = "bone/eqep/0";
};

&eqep1 {
	status = "okay";
	pinctrl-names = "default";
	pinctrl-0 = <>;

	count_mode = <0>; /* 0 - Quadrature mode, normal 90 phase offset cha & chb. 1 - Direction mode. cha input = clock, chb input = direction */
	swap_inputs = <0>; /* Are channel A and channel B swapped? (0 - no, 1 - yes) */
	invert_qa = <1>; /* Should we invert the channel A input? */
	invert_qb = <1>; /* Should we invert the channel B input? I invert these because my encoder outputs drive transistors that pull down the pins */
	invert_qi = <0>; /* Should we invert the index input? */
	invert_qs = <0>; /* Should we invert the strobe input? */
	symlink = "bone/eqep/1";
};

&eqep2 {
	status = "okay";
	pinctrl-names = "default";
	pinctrl-0 = <>;

	count_mode = <0>; /* 0 - Quadrature mode, normal 90 phase offset cha & chb. 1 - Direction mode. cha input = clock, chb input = direction */
	swap_inputs = <0>; /* Are channel A and channel B swapped? (0 - no, 1 - yes) */
	invert_qa = <1>; /* Should we invert the channel A input? */
	invert_qb = <1>; /* Should we invert the channel B input? I invert these because my encoder outputs drive transistors that pull down the pins */
	invert_qi = <0>; /* Should we invert the index input? */
	invert_qs = <0>; /* Should we invert the strobe input? */
	symlink = "bone/eqep/2";
};

&epwmss0 {
	status = "okay";
};

&epwmss1 {
	status = "okay";
};

&epwmss2 {
	status = "okay";
};

&ehrpwm0 {
	status = "okay";
	pinctrl-names = "default";
	pinctrl-0 = <>;
};

&ehrpwm1 {
	status = "okay";
	pinctrl-names = "default";
	pinctrl-0 = <>;
};

&ehrpwm2 {
	status = "okay";
	pinctrl-names = "default";
	pinctrl-0 = <>;
};

&ecap0 {
	status = "okay";
	pinctrl-names = "default";
	pinctrl-0 = <>;
};

&ecap1 {
	status = "okay";
	pinctrl-names = "default";
	pinctrl-0 = <>;
};

&ecap2 {
	status = "okay";
	pinctrl-names = "default";
	pinctrl-0 = <>;
};

&spi0 {
	status = "okay";
	pinctrl-names = "default";
	pinctrl-0 = <>;

	channel@0 {
		#address-cells = <1>;
		#size-cells = <0>;

		compatible = "spidev";
		symlink = "spi/0.0";

		reg = <0>;
		spi-max-frequency = <16000000>;
		spi-cpha;
	};

	channel@1 {
		#address-cells = <1>;
		#size-cells = <0>;

		compatible = "spidev";
		symlink = "spi/0.1";

		reg = <1>;
		spi-max-frequency = <16000000>;
	};
};

&spi1 {
	status = "okay";
	pinctrl-names = "default";
	pinctrl-0 = <>;

	channel@0 {
		#address-cells = <1>;
		#size-cells = <0>;

		compatible = "spidev";
		symlink = "spi/1.0";

		reg = <0>;
		spi-max-frequency = <16000000>;
		spi-cpha;
	};

	channel@1 {
		#address-cells = <1>;
		#size-cells = <0>;

		compatible = "spidev";
		symlink = "spi/1.1";

		reg = <1>;
		spi-max-frequency = <16000000>;
	};
};

/**********************************************************************/
/* Pin Multiplex Helpers                                              */
/*                                                                    */
/* These provide userspace runtime pin configuration for the          */
/* BeagleBone cape expansion headers                                  */
/**********************************************************************/

&ocp {
	/************************/
	/* P8 Header */
	/************************/

	/* P8_01                GND */

	/* P8_02                GND */


	/* P8_03 (ZCZ ball R9) emmc */

	/* P8_04 (ZCZ ball T9) emmc */

	/* P8_05 (ZCZ ball R8) emmc */

	/* P8_06 (ZCZ ball T8) emmc */

	/* P8_07 (ZCZ ball R7) */
	P8_07_pinmux {
		compatible = "bone-pinmux-helper";
		status = "okay";
		pinctrl-names = "default", "gpio", "gpio_pu", "gpio_pd", "timer";
		pinctrl-0 = <&P8_07_default_pin>;
		pinctrl-1 = <&P8_07_gpio_pin>;
		pinctrl-2 = <&P8_07_gpio_pu_pin>;
		pinctrl-3 = <&P8_07_gpio_pd_pin>;
		pinctrl-4 = <&P8_07_timer_pin>;
	};

	/* P8_08 (ZCZ ball T7) */
	P8_08_pinmux {
		compatible = "bone-pinmux-helper";
		status = "okay";
		pinctrl-names = "default", "gpio", "gpio_pu", "gpio_pd", "timer";
		pinctrl-0 = <&P8_08_default_pin>;
		pinctrl-1 = <&P8_08_gpio_pin>;
		pinctrl-2 = <&P8_08_gpio_pu_pin>;
		pinctrl-3 = <&P8_08_gpio_pd_pin>;
		pinctrl-4 = <&P8_08_timer_pin>;
	};

	/* P8_09 (ZCZ ball T6) */
	P8_09_pinmux {
		compatible = "bone-pinmux-helper";
		status = "okay";
		pinctrl-names = "default", "gpio", "gpio_pu", "gpio_pd", "timer";
		pinctrl-0 = <&P8_09_default_pin>;
		pinctrl-1 = <&P8_09_gpio_pin>;
		pinctrl-2 = <&P8_09_gpio_pu_pin>;
		pinctrl-3 = <&P8_09_gpio_pd_pin>;
		pinctrl-4 = <&P8_09_timer_pin>;
	};

	/* P8_10 (ZCZ ball U6) */
	P8_10_pinmux {
		compatible = "bone-pinmux-helper";
		status = "okay";
		pinctrl-names = "default", "gpio", "gpio_pu", "gpio_pd", "timer";
		pinctrl-0 = <&P8_10_default_pin>;
		pinctrl-1 = <&P8_10_gpio_pin>;
		pinctrl-2 = <&P8_10_gpio_pu_pin>;
		pinctrl-3 = <&P8_10_gpio_pd_pin>;
		pinctrl-4 = <&P8_10_timer_pin>;
	};

	/* P8_11 (ZCZ ball R12) */
	P8_11_pinmux {
		compatible = "bone-pinmux-helper";
		status = "okay";
		pinctrl-names = "default", "gpio", "gpio_pu", "gpio_pd", "eqep", "pruout";
		pinctrl-0 = <&P8_11_default_pin>;
		pinctrl-1 = <&P8_11_gpio_pin>;
		pinctrl-2 = <&P8_11_gpio_pu_pin>;
		pinctrl-3 = <&P8_11_gpio_pd_pin>;
		pinctrl-4 = <&P8_11_eqep_pin>;
		pinctrl-5 = <&P8_11_pruout_pin>;
	};

	/* P8_12 (ZCZ ball T12) */
	P8_12_pinmux {
		compatible = "bone-pinmux-helper";
		status = "okay";
		pinctrl-names = "default", "gpio", "gpio_pu", "gpio_pd", "eqep", "pruout";
		pinctrl-0 = <&P8_12_default_pin>;
		pinctrl-1 = <&P8_12_gpio_pin>;
		pinctrl-2 = <&P8_12_gpio_pu_pin>;
		pinctrl-3 = <&P8_12_gpio_pd_pin>;
		pinctrl-4 = <&P8_12_eqep_pin>;
		pinctrl-5 = <&P8_12_pruout_pin>;
	};

	/* P8_13 (ZCZ ball T10) */
	P8_13_pinmux {
		compatible = "bone-pinmux-helper";
		status = "okay";
		pinctrl-names = "default", "gpio", "gpio_pu", "gpio_pd", "pwm";
		pinctrl-0 = <&P8_13_default_pin>;
		pinctrl-1 = <&P8_13_gpio_pin>;
		pinctrl-2 = <&P8_13_gpio_pu_pin>;
		pinctrl-3 = <&P8_13_gpio_pd_pin>;
		pinctrl-4 = <&P8_13_pwm_pin>;
	};

	/* P8_14 (ZCZ ball T11) */
	P8_14_pinmux {
		compatible = "bone-pinmux-helper";
		status = "okay";
		pinctrl-names = "default", "gpio", "gpio_pu", "gpio_pd", "pwm";
		pinctrl-0 = <&P8_14_default_pin>;
		pinctrl-1 = <&P8_14_gpio_pin>;
		pinctrl-2 = <&P8_14_gpio_pu_pin>;
		pinctrl-3 = <&P8_14_gpio_pd_pin>;
		pinctrl-4 = <&P8_14_pwm_pin>;
	};

	/* P8_15 (ZCZ ball U13) */
	P8_15_pinmux {
		compatible = "bone-pinmux-helper";
		status = "okay";
		pinctrl-names = "default", "gpio", "gpio_pu", "gpio_pd", "eqep", "pru_ecap_pwm", "pruin";
		pinctrl-0 = <&P8_15_default_pin>;
		pinctrl-1 = <&P8_15_gpio_pin>;
		pinctrl-2 = <&P8_15_gpio_pu_pin>;
		pinctrl-3 = <&P8_15_gpio_pd_pin>;
		pinctrl-4 = <&P8_15_eqep_pin>;
		pinctrl-5 = <&P8_15_pru_ecap_pwm_pin>;
		pinctrl-6 = <&P8_15_pruin_pin>;
	};

	/* P8_16 (ZCZ ball V13) */
	P8_16_pinmux {
		compatible = "bone-pinmux-helper";
		status = "okay";
		pinctrl-names = "default", "gpio", "gpio_pu", "gpio_pd", "eqep", "pruin";
		pinctrl-0 = <&P8_16_default_pin>;
		pinctrl-1 = <&P8_16_gpio_pin>;
		pinctrl-2 = <&P8_16_gpio_pu_pin>;
		pinctrl-3 = <&P8_16_gpio_pd_pin>;
		pinctrl-4 = <&P8_16_eqep_pin>;
		pinctrl-5 = <&P8_16_pruin_pin>;
	};

	/* P8_17 (ZCZ ball U12) */
	P8_17_pinmux {
		compatible = "bone-pinmux-helper";
		status = "okay";
		pinctrl-names = "default", "gpio", "gpio_pu", "gpio_pd", "pwm";
		pinctrl-0 = <&P8_17_default_pin>;
		pinctrl-1 = <&P8_17_gpio_pin>;
		pinctrl-2 = <&P8_17_gpio_pu_pin>;
		pinctrl-3 = <&P8_17_gpio_pd_pin>;
		pinctrl-4 = <&P8_17_pwm_pin>;
	};

	/* P8_18 (ZCZ ball V12) */
	P8_18_pinmux {
		compatible = "bone-pinmux-helper";
		status = "okay";
		pinctrl-names = "default", "gpio", "gpio_pu", "gpio_pd";
		pinctrl-0 = <&P8_18_default_pin>;
		pinctrl-1 = <&P8_18_gpio_pin>;
		pinctrl-2 = <&P8_18_gpio_pu_pin>;
		pinctrl-3 = <&P8_18_gpio_pd_pin>;
	};

	/* P8_19 (ZCZ ball U10) */
	P8_19_pinmux {
		compatible = "bone-pinmux-helper";
		status = "okay";
		pinctrl-names = "default", "gpio", "gpio_pu", "gpio_pd", "pwm";
		pinctrl-0 = <&P8_19_default_pin>;
		pinctrl-1 = <&P8_19_gpio_pin>;
		pinctrl-2 = <&P8_19_gpio_pu_pin>;
		pinctrl-3 = <&P8_19_gpio_pd_pin>;
		pinctrl-4 = <&P8_19_pwm_pin>;
	};

	/* P8_20 (ZCZ ball V9) emmc */

	/* P8_21 (ZCZ ball U9) emmc */

	/* P8_22 (ZCZ ball V8) emmc */

	/* P8_23 (ZCZ ball U8) emmc */

	/* P8_24 (ZCZ ball V7) emmc */

	/* P8_25 (ZCZ ball U7) emmc */

	/* P8_26 (ZCZ ball V6) */
	P8_26_pinmux {
		compatible = "bone-pinmux-helper";
		status = "okay";
		pinctrl-names = "default", "gpio", "gpio_pu", "gpio_pd";
		pinctrl-0 = <&P8_26_default_pin>;
		pinctrl-1 = <&P8_26_gpio_pin>;
		pinctrl-2 = <&P8_26_gpio_pu_pin>;
		pinctrl-3 = <&P8_26_gpio_pd_pin>;
	};

	/* P8_27 (ZCZ ball U5) hdmi */
	P8_27_pinmux {
		compatible = "bone-pinmux-helper";
		status = "okay";
		pinctrl-names = "default", "gpio", "gpio_pu", "gpio_pd", "pruout", "pruin";
		pinctrl-0 = <&P8_27_default_pin>;
		pinctrl-1 = <&P8_27_gpio_pin>;
		pinctrl-2 = <&P8_27_gpio_pu_pin>;
		pinctrl-3 = <&P8_27_gpio_pd_pin>;
		pinctrl-4 = <&P8_27_pruout_pin>;
		pinctrl-5 = <&P8_27_pruin_pin>;
	};

	/* P8_28 (ZCZ ball V5) hdmi */
	P8_28_pinmux {
		compatible = "bone-pinmux-helper";
		status = "okay";
		pinctrl-names = "default", "gpio", "gpio_pu", "gpio_pd", "pruout", "pruin";
		pinctrl-0 = <&P8_28_default_pin>;
		pinctrl-1 = <&P8_28_gpio_pin>;
		pinctrl-2 = <&P8_28_gpio_pu_pin>;
		pinctrl-3 = <&P8_28_gpio_pd_pin>;
		pinctrl-4 = <&P8_28_pruout_pin>;
		pinctrl-5 = <&P8_28_pruin_pin>;
	};

	/* P8_29 (ZCZ ball R5) hdmi */
	P8_29_pinmux {
		compatible = "bone-pinmux-helper";
		status = "okay";
		pinctrl-names = "default", "gpio", "gpio_pu", "gpio_pd", "pruout", "pruin";
		pinctrl-0 = <&P8_29_default_pin>;
		pinctrl-1 = <&P8_29_gpio_pin>;
		pinctrl-2 = <&P8_29_gpio_pu_pin>;
		pinctrl-3 = <&P8_29_gpio_pd_pin>;
		pinctrl-4 = <&P8_29_pruout_pin>;
		pinctrl-5 = <&P8_29_pruin_pin>;
	};

	/* P8_30 (ZCZ ball R6) hdmi */
	P8_30_pinmux {
		compatible = "bone-pinmux-helper";
		status = "okay";
		pinctrl-names = "default", "gpio", "gpio_pu", "gpio_pd", "pruout", "pruin";
		pinctrl-0 = <&P8_30_default_pin>;
		pinctrl-1 = <&P8_30_gpio_pin>;
		pinctrl-2 = <&P8_30_gpio_pu_pin>;
		pinctrl-3 = <&P8_30_gpio_pd_pin>;
		pinctrl-4 = <&P8_30_pruout_pin>;
		pinctrl-5 = <&P8_30_pruin_pin>;
	};

	/* P8_31 (ZCZ ball V4) hdmi */
	P8_31_pinmux {
		compatible = "bone-pinmux-helper";
		status = "okay";
		pinctrl-names = "default", "gpio", "gpio_pu", "gpio_pd", "uart", "eqep";
		pinctrl-0 = <&P8_31_default_pin>;
		pinctrl-1 = <&P8_31_gpio_pin>;
		pinctrl-2 = <&P8_31_gpio_pu_pin>;
		pinctrl-3 = <&P8_31_gpio_pd_pin>;
		pinctrl-4 = <&P8_31_uart_pin>;
		pinctrl-5 = <&P8_31_eqep_pin>;
	};

	/* P8_32 (ZCZ ball T5) hdmi */
	P8_32_pinmux {
		compatible = "bone-pinmux-helper";
		status = "okay";
		pinctrl-names = "default", "gpio", "gpio_pu", "gpio_pd", "eqep";
		pinctrl-0 = <&P8_32_default_pin>;
		pinctrl-1 = <&P8_32_gpio_pin>;
		pinctrl-2 = <&P8_32_gpio_pu_pin>;
		pinctrl-3 = <&P8_32_gpio_pd_pin>;
		pinctrl-4 = <&P8_32_eqep_pin>;
	};

	/* P8_33 (ZCZ ball V3) hdmi */
	P8_33_pinmux {
		compatible = "bone-pinmux-helper";
		status = "okay";
		pinctrl-names = "default", "gpio", "gpio_pu", "gpio_pd", "eqep";
		pinctrl-0 = <&P8_33_default_pin>;
		pinctrl-1 = <&P8_33_gpio_pin>;
		pinctrl-2 = <&P8_33_gpio_pu_pin>;
		pinctrl-3 = <&P8_33_gpio_pd_pin>;
		pinctrl-4 = <&P8_33_eqep_pin>;
	};

	/* P8_34 (ZCZ ball U4) hdmi */
	P8_34_pinmux {
		compatible = "bone-pinmux-helper";
		status = "okay";
		pinctrl-names = "default", "gpio", "gpio_pu", "gpio_pd", "pwm";
		pinctrl-0 = <&P8_34_default_pin>;
		pinctrl-1 = <&P8_34_gpio_pin>;
		pinctrl-2 = <&P8_34_gpio_pu_pin>;
		pinctrl-3 = <&P8_34_gpio_pd_pin>;
		pinctrl-4 = <&P8_34_pwm_pin>;
	};

	/* P8_35 (ZCZ ball V2) hdmi */
	P8_35_pinmux {
		compatible = "bone-pinmux-helper";
		status = "okay";
		pinctrl-names = "default", "gpio", "gpio_pu", "gpio_pd", "eqep";
		pinctrl-0 = <&P8_35_default_pin>;
		pinctrl-1 = <&P8_35_gpio_pin>;
		pinctrl-2 = <&P8_35_gpio_pu_pin>;
		pinctrl-3 = <&P8_35_gpio_pd_pin>;
		pinctrl-4 = <&P8_35_eqep_pin>;
	};

	/* P8_36 (ZCZ ball U3) hdmi */
	P8_36_pinmux {
		compatible = "bone-pinmux-helper";
		status = "okay";
		pinctrl-names = "default", "gpio", "gpio_pu", "gpio_pd", "pwm";
		pinctrl-0 = <&P8_36_default_pin>;
		pinctrl-1 = <&P8_36_gpio_pin>;
		pinctrl-2 = <&P8_36_gpio_pu_pin>;
		pinctrl-3 = <&P8_36_gpio_pd_pin>;
		pinctrl-4 = <&P8_36_pwm_pin>;
	};

	/* P8_37 (ZCZ ball U1) hdmi */
	P8_37_pinmux {
		compatible = "bone-pinmux-helper";
		status = "okay";
		pinctrl-names = "default", "gpio", "gpio_pu", "gpio_pd", "uart", "pwm";
		pinctrl-0 = <&P8_37_default_pin>;
		pinctrl-1 = <&P8_37_gpio_pin>;
		pinctrl-2 = <&P8_37_gpio_pu_pin>;
		pinctrl-3 = <&P8_37_gpio_pd_pin>;
		pinctrl-4 = <&P8_37_uart_pin>;
		pinctrl-5 = <&P8_37_pwm_pin>;
	};

	/* P8_38 (ZCZ ball U2) hdmi */
	P8_38_pinmux {
		compatible = "bone-pinmux-helper";
		status = "okay";
		pinctrl-names = "default", "gpio", "gpio_pu", "gpio_pd", "uart", "pwm";
		pinctrl-0 = <&P8_38_default_pin>;
		pinctrl-1 = <&P8_38_gpio_pin>;
		pinctrl-2 = <&P8_38_gpio_pu_pin>;
		pinctrl-3 = <&P8_38_gpio_pd_pin>;
		pinctrl-4 = <&P8_38_uart_pin>;
		pinctrl-5 = <&P8_38_pwm_pin>;
	};

	/* P8_39 (ZCZ ball T3) hdmi */
	P8_39_pinmux {
		compatible = "bone-pinmux-helper";
		status = "okay";
		pinctrl-names = "default", "gpio", "gpio_pu", "gpio_pd", "eqep", "pruout", "pruin";
		pinctrl-0 = <&P8_39_default_pin>;
		pinctrl-1 = <&P8_39_gpio_pin>;
		pinctrl-2 = <&P8_39_gpio_pu_pin>;
		pinctrl-3 = <&P8_39_gpio_pd_pin>;
		pinctrl-4 = <&P8_39_eqep_pin>;
		pinctrl-5 = <&P8_39_pruout_pin>;
		pinctrl-6 = <&P8_39_pruin_pin>;
	};

	/* P8_40 (ZCZ ball T4) hdmi */
	P8_40_pinmux {
		compatible = "bone-pinmux-helper";
		status = "okay";
		pinctrl-names = "default", "gpio", "gpio_pu", "gpio_pd", "eqep", "pruout", "pruin";
		pinctrl-0 = <&P8_40_default_pin>;
		pinctrl-1 = <&P8_40_gpio_pin>;
		pinctrl-2 = <&P8_40_gpio_pu_pin>;
		pinctrl-3 = <&P8_40_gpio_pd_pin>;
		pinctrl-4 = <&P8_40_eqep_pin>;
		pinctrl-5 = <&P8_40_pruout_pin>;
		pinctrl-6 = <&P8_40_pruin_pin>;
	};

	/* P8_41 (ZCZ ball T1) hdmi */
	P8_41_pinmux {
		compatible = "bone-pinmux-helper";
		status = "okay";
		pinctrl-names = "default", "gpio", "gpio_pu", "gpio_pd", "eqep", "pruout", "pruin";
		pinctrl-0 = <&P8_41_default_pin>;
		pinctrl-1 = <&P8_41_gpio_pin>;
		pinctrl-2 = <&P8_41_gpio_pu_pin>;
		pinctrl-3 = <&P8_41_gpio_pd_pin>;
		pinctrl-4 = <&P8_41_eqep_pin>;
		pinctrl-5 = <&P8_41_pruout_pin>;
		pinctrl-6 = <&P8_41_pruin_pin>;
	};

	/* P8_42 (ZCZ ball T2) hdmi */
	P8_42_pinmux {
		compatible = "bone-pinmux-helper";
		status = "okay";
		pinctrl-names = "default", "gpio", "gpio_pu", "gpio_pd", "eqep", "pruout", "pruin";
		pinctrl-0 = <&P8_42_default_pin>;
		pinctrl-1 = <&P8_42_gpio_pin>;
		pinctrl-2 = <&P8_42_gpio_pu_pin>;
		pinctrl-3 = <&P8_42_gpio_pd_pin>;
		pinctrl-4 = <&P8_42_eqep_pin>;
		pinctrl-5 = <&P8_42_pruout_pin>;
		pinctrl-6 = <&P8_42_pruin_pin>;
	};

	/* P8_43 (ZCZ ball R3) hdmi */
	P8_43_pinmux {
		compatible = "bone-pinmux-helper";
		status = "okay";
		pinctrl-names = "default", "gpio", "gpio_pu", "gpio_pd", "pwm", "pruout", "pruin";
		pinctrl-0 = <&P8_43_default_pin>;
		pinctrl-1 = <&P8_43_gpio_pin>;
		pinctrl-2 = <&P8_43_gpio_pu_pin>;
		pinctrl-3 = <&P8_43_gpio_pd_pin>;
		pinctrl-4 = <&P8_43_pwm_pin>;
		pinctrl-5 = <&P8_43_pruout_pin>;
		pinctrl-6 = <&P8_43_pruin_pin>;
	};

	/* P8_44 (ZCZ ball R4) hdmi */
	P8_44_pinmux {
		compatible = "bone-pinmux-helper";
		status = "okay";
		pinctrl-names = "default", "gpio", "gpio_pu", "gpio_pd", "pwm", "pruout", "pruin";
		pinctrl-0 = <&P8_44_default_pin>;
		pinctrl-1 = <&P8_44_gpio_pin>;
		pinctrl-2 = <&P8_44_gpio_pu_pin>;
		pinctrl-3 = <&P8_44_gpio_pd_pin>;
		pinctrl-4 = <&P8_44_pwm_pin>;
		pinctrl-5 = <&P8_44_pruout_pin>;
		pinctrl-6 = <&P8_44_pruin_pin>;
	};

	/* P8_45 (ZCZ ball R1) hdmi */
	P8_45_pinmux {
		compatible = "bone-pinmux-helper";
		status = "okay";
		pinctrl-names = "default", "gpio", "gpio_pu", "gpio_pd", "pwm", "pruout", "pruin";
		pinctrl-0 = <&P8_45_default_pin>;
		pinctrl-1 = <&P8_45_gpio_pin>;
		pinctrl-2 = <&P8_45_gpio_pu_pin>;
		pinctrl-3 = <&P8_45_gpio_pd_pin>;
		pinctrl-4 = <&P8_45_pwm_pin>;
		pinctrl-5 = <&P8_45_pruout_pin>;
		pinctrl-6 = <&P8_45_pruin_pin>;
	};

	/* P8_46 (ZCZ ball R2) hdmi */
	P8_46_pinmux {
		compatible = "bone-pinmux-helper";
		status = "okay";
		pinctrl-names = "default", "gpio", "gpio_pu", "gpio_pd", "pwm", "pruout", "pruin";
		pinctrl-0 = <&P8_46_default_pin>;
		pinctrl-1 = <&P8_46_gpio_pin>;
		pinctrl-2 = <&P8_46_gpio_pu_pin>;
		pinctrl-3 = <&P8_46_gpio_pd_pin>;
		pinctrl-4 = <&P8_46_pwm_pin>;
		pinctrl-5 = <&P8_46_pruout_pin>;
		pinctrl-6 = <&P8_46_pruin_pin>;
	};

	/************************/
	/* P9 Header */
	/************************/

	/* P9_01                GND */

	/* P9_02                GND */

	/* P9_03                3V3 */

	/* P9_04                3V3 */

	/* P9_05                VDD_5V */

	/* P9_06                VDD_5V */

	/* P9_07                SYS_5V */

	/* P9_08                SYS_5V */

	/* P9_09                PWR_BUT */

	/* P9_10                RSTn */

	/* P9_11 (ZCZ ball T17) */
	P9_11_pinmux {
		compatible = "bone-pinmux-helper";
		status = "okay";
		pinctrl-names = "default", "gpio", "gpio_pu", "gpio_pd", "uart";
		pinctrl-0 = <&P9_11_default_pin>;
		pinctrl-1 = <&P9_11_gpio_pin>;
		pinctrl-2 = <&P9_11_gpio_pu_pin>;
		pinctrl-3 = <&P9_11_gpio_pd_pin>;
		pinctrl-4 = <&P9_11_uart_pin>;
	};

	/* P9_12 (ZCZ ball U18) */
	P9_12_pinmux {
		compatible = "bone-pinmux-helper";
		status = "okay";
		pinctrl-names = "default", "gpio", "gpio_pu", "gpio_pd";
		pinctrl-0 = <&P9_12_default_pin>;
		pinctrl-1 = <&P9_12_gpio_pin>;
		pinctrl-2 = <&P9_12_gpio_pu_pin>;
		pinctrl-3 = <&P9_12_gpio_pd_pin>;
		pinctrl-4 = <&P9_12_mcasp_pin>;
	};

	/* P9_13 (ZCZ ball U17) */
	P9_13_pinmux {
		compatible = "bone-pinmux-helper";
		status = "okay";
		pinctrl-names = "default", "gpio", "gpio_pu", "gpio_pd", "uart";
		pinctrl-0 = <&P9_13_default_pin>;
		pinctrl-1 = <&P9_13_gpio_pin>;
		pinctrl-2 = <&P9_13_gpio_pu_pin>;
		pinctrl-3 = <&P9_13_gpio_pd_pin>;
		pinctrl-4 = <&P9_13_uart_pin>;
	};

	/* P9_14 (ZCZ ball U14) */

	/* P9_15 (ZCZ ball R13) */
	P9_15_pinmux {
		compatible = "bone-pinmux-helper";
		status = "okay";
		pinctrl-names = "default", "gpio", "gpio_pu", "gpio_pd", "pwm";
		pinctrl-0 = <&P9_15_default_pin>;
		pinctrl-1 = <&P9_15_gpio_pin>;
		pinctrl-2 = <&P9_15_gpio_pu_pin>;
		pinctrl-3 = <&P9_15_gpio_pd_pin>;
		pinctrl-4 = <&P9_15_pwm_pin>;
	};

	/* P9_16 (ZCZ ball T14) */
	P9_16_pinmux {
		compatible = "bone-pinmux-helper";
		status = "okay";
		pinctrl-names = "default", "gpio", "gpio_pu", "gpio_pd", "pwm";
		pinctrl-0 = <&P9_16_default_pin>;
		pinctrl-1 = <&P9_16_gpio_pin>;
		pinctrl-2 = <&P9_16_gpio_pu_pin>;
		pinctrl-3 = <&P9_16_gpio_pd_pin>;
		pinctrl-4 = <&P9_16_pwm_pin>;
	};

	/* P9_17 (ZCZ ball A16) */

	/* P9_18 (ZCZ ball B16) */

	/* P9_19 (ZCZ ball D17) i2c */

	/* P9_20 (ZCZ ball D18) i2c */

	/* P9_21 (ZCZ ball B17) */

	/* P9_22 (ZCZ ball A17) */

	/* P9_23 (ZCZ ball V14) */
	P9_23_pinmux {
		compatible = "bone-pinmux-helper";
		status = "okay";
		pinctrl-names = "default", "gpio", "gpio_pu", "gpio_pd", "pwm";
		pinctrl-0 = <&P9_23_default_pin>;
		pinctrl-1 = <&P9_23_gpio_pin>;
		pinctrl-2 = <&P9_23_gpio_pu_pin>;
		pinctrl-3 = <&P9_23_gpio_pd_pin>;
		pinctrl-4 = <&P9_23_pwm_pin>;
	};

	/* P9_24 (ZCZ ball D15) */

	/* P9_25 (ZCZ ball A14) audio */

	/* P9_26 (ZCZ ball D16) */

	/* P9_27 (ZCZ ball C13) */

	/* P9_28 (ZCZ ball C12) audio */
	P9_28_pinmux {
		compatible = "bone-pinmux-helper";
		status = "okay";
		pinctrl-names = "default", "gpio", "gpio_pu", "gpio_pd", "spi_cs", "pwm", "pwm2", "pruout", "pruin";
		pinctrl-0 = <&P9_28_default_pin>;
		pinctrl-1 = <&P9_28_gpio_pin>;
		pinctrl-2 = <&P9_28_gpio_pu_pin>;
		pinctrl-3 = <&P9_28_gpio_pd_pin>;
		pinctrl-4 = <&P9_28_spi_cs_pin>;
		pinctrl-5 = <&P9_28_pwm_pin>;
		pinctrl-6 = <&P9_28_ecap_pwm_pin>;
		pinctrl-7 = <&P9_28_pruout_pin>;
		pinctrl-8 = <&P9_28_pruin_pin>;
		pinctrl-9 = <&P9_28_mcasp_pin>;
	};

	/* P9_29 (ZCZ ball B13) audio */

	/* P9_30 (ZCZ ball D12) */

	/* P9_31 (ZCZ ball A13) audio */

	/* P9_32                VADC */

	/* P9_33 (ZCZ ball C8)  AIN4         */

	/* P9_34                AGND */

	/* P9_35 (ZCZ ball A8)  AIN6         */

	/* P9_36 (ZCZ ball B8)  AIN5         */

	/* P9_37 (ZCZ ball B7)  AIN2         */

	/* P9_38 (ZCZ ball A7)  AIN3         */

	/* P9_39 (ZCZ ball B6)  AIN0         */

	/* P9_40 (ZCZ ball C7)  AIN1         */

	/* P9_41 (ZCZ ball D14) */

	/* P9_41.1 */
	/* P9_91 (ZCZ ball D13) */

	/* P9_42 (ZCZ ball C18) */

	/* P9_42.1 */
	/* P9_92 (ZCZ ball B12) */

	/* P9_43                GND */

	/* P9_44                GND */

	/* P9_45                GND */

	/* P9_46                GND */

	/*       (ZCZ ball A15) */
	A15_pinmux {
		compatible = "bone-pinmux-helper";
		status = "okay";
		pinctrl-names = "default", "clkout", "gpio", "gpio_pu", "gpio_pd";
		pinctrl-0 = <&A15_default_pin>;
		pinctrl-1 = <&A15_clkout_pin>;
		pinctrl-2 = <&A15_gpio_pin>;
		pinctrl-3 = <&A15_gpio_pu_pin>;
		pinctrl-4 = <&A15_gpio_pd_pin>;
	};

	cape-universal {
		compatible = "gpio-of-helper";
		status = "okay";
		pinctrl-names = "default";
		pinctrl-0 = <>;

		P8_07 {
			gpio-name = "P8_07";
			gpio = <&gpio2 2 0>;
			input;
			dir-changeable;
		};

		P8_08 {
			gpio-name = "P8_08";
			gpio = <&gpio2 3 0>;
			input;
			dir-changeable;
		};

		P8_09 {
			gpio-name = "P8_09";
			gpio = <&gpio2 5 0>;
			input;
			dir-changeable;
		};

		P8_10 {
			gpio-name = "P8_10";
			gpio = <&gpio2 4 0>;
			input;
			dir-changeable;
		};

		P8_11 {
			gpio-name = "P8_11";
			gpio = <&gpio1 13 0>;
			input;
			dir-changeable;
		};

		P8_12 {
			gpio-name = "P8_12";
			gpio = <&gpio1 12 0>;
			input;
			dir-changeable;
		};

		P8_13 {
			gpio-name = "P8_13";
			gpio = <&gpio0 23 0>;
			input;
			dir-changeable;
		};

		P8_14 {
			gpio-name = "P8_14";
			gpio = <&gpio0 26 0>;
			input;
			dir-changeable;
		};

		P8_15 {
			gpio-name = "P8_15";
			gpio = <&gpio1 15 0>;
			input;
			dir-changeable;
		};

		P8_16 {
			gpio-name = "P8_16";
			gpio = <&gpio1 14 0>;
			input;
			dir-changeable;
		};

		P8_17 {
			gpio-name = "P8_17";
			gpio = <&gpio0 27 0>;
			input;
			dir-changeable;
		};

		P8_18 {
			gpio-name = "P8_18";
			gpio = <&gpio2 1 0>;
			input;
			dir-changeable;
		};

		P8_19 {
			gpio-name = "P8_19";
			gpio = <&gpio0 22 0>;
			input;
			dir-changeable;
		};

		P8_26 {
			gpio-name = "P8_26";
			gpio = <&gpio1 29 0>;
			input;
			dir-changeable;
		};

		P8_27 {
			gpio-name = "P8_27";
			gpio = <&gpio2 22 0>;
			input;
			dir-changeable;
		};

		P8_28 {
			gpio-name = "P8_28";
			gpio = <&gpio2 24 0>;
			input;
			dir-changeable;
		};

		P8_29 {
			gpio-name = "P8_29";
			gpio = <&gpio2 23 0>;
			input;
			dir-changeable;
		};

		P8_30 {
			gpio-name = "P8_30";
			gpio = <&gpio2 25 0>;
			input;
			dir-changeable;
		};

		P8_31 {
			gpio-name = "P8_31";
			gpio = <&gpio0 10 0>;
			input;
			dir-changeable;
		};

		P8_32 {
			gpio-name = "P8_32";
			gpio = <&gpio0 11 0>;
			input;
			dir-changeable;
		};

		P8_33 {
			gpio-name = "P8_33";
			gpio = <&gpio0 9 0>;
			input;
			dir-changeable;
		};

		P8_34 {
			gpio-name = "P8_34";
			gpio = <&gpio2 17 0>;
			input;
			dir-changeable;
		};

		P8_35 {
			gpio-name = "P8_35";
			gpio = <&gpio0 8 0>;
			input;
			dir-changeable;
		};

		P8_36 {
			gpio-name = "P8_36";
			gpio = <&gpio2 16 0>;
			input;
			dir-changeable;
		};

		P8_37 {
			gpio-name = "P8_37";
			gpio = <&gpio2 14 0>;
			input;
			dir-changeable;
		};

		P8_38 {
			gpio-name = "P8_38";
			gpio = <&gpio2 15 0>;
			input;
			dir-changeable;
		};

		P8_39 {
			gpio-name = "P8_39";
			gpio = <&gpio2 12 0>;
			input;
			dir-changeable;
		};

		P8_40 {
			gpio-name = "P8_40";
			gpio = <&gpio2 13 0>;
			input;
			dir-changeable;
		};

		P8_41 {
			gpio-name = "P8_41";
			gpio = <&gpio2 10 0>;
			input;
			dir-changeable;
		};

		P8_42 {
			gpio-name = "P8_42";
			gpio = <&gpio2 11 0>;
			input;
			dir-changeable;
		};

		P8_43 {
			gpio-name = "P8_43";
			gpio = <&gpio2 8 0>;
			input;
			dir-changeable;
		};

		P8_44 {
			gpio-name = "P8_44";
			gpio = <&gpio2 9 0>;
			input;
			dir-changeable;
		};

		P8_45 {
			gpio-name = "P8_45";
			gpio = <&gpio2 6 0>;
			input;
			dir-changeable;
		};

		P8_46 {
			gpio-name = "P8_46";
			gpio = <&gpio2 7 0>;
			input;
			dir-changeable;
		};

		P9_11 {
			gpio-name = "P9_11";
			gpio = <&gpio0 30 0>;
			input;
			dir-changeable;
		};

		P9_12 {
			gpio-name = "P9_12";
			gpio = <&gpio1 28 0>;
			input;
			dir-changeable;
		};

		P9_13 {
			gpio-name = "P9_13";
			gpio = <&gpio0 31 0>;
			input;
			dir-changeable;
		};

		P9_15 {
			gpio-name = "P9_15";
			gpio = <&gpio1 16 0>;
			input;
			dir-changeable;
		};

		P9_16 {
			gpio-name = "P9_16";
			gpio = <&gpio1 19 0>;
			input;
			dir-changeable;
		};

		P9_23 {
			gpio-name = "P9_23";
			gpio = <&gpio1 17 0>;
			input;
			dir-changeable;
		};

		P9_28 {
			gpio-name = "P9_28";
			gpio = <&gpio3 17 0>;
			input;
			dir-changeable;
		};

		A15 {
			gpio-name = "A15";
			gpio = <&gpio0 19 0>;
			input;
			dir-changeable;
		};
	};
};
