## sound/soc/generic/Kconfig
```kconfig
config SND_SIMPLE_CARD_UTILS
       tristate

config SND_SIMPLE_CARD
	tristate "ASoC Simple sound card support"
	select SND_SIMPLE_CARD_UTILS
	help
	  This option enables generic simple sound card support

config SND_SIMPLE_SCU_CARD
	tristate "ASoC Simple SCU sound card support"
	depends on OF
	select SND_SIMPLE_CARD_UTILS
	help
	  This option enables generic simple SCU sound card support.
	  It supports DPCM of multi CPU single Codec system.

config SND_BOTIC_CARD
	tristate "ASoC Botic sound card support"
	help
	  This option enables Botic sound card support

config SND_AM33XX_SOC_BOTIC
	tristate "Botic on BeagleBone Black"
	depends on SOC_AM33XX
	select SND_BOTIC_CARD
	select SND_SOC_DAVINCI_MCASP
	help
	  Say Y or M if you want to add support for Botic on BeagleBone Black.

config SND_AUDIO_GRAPH_CARD
	tristate "ASoC Audio Graph sound card support"
	depends on OF
	select SND_SIMPLE_CARD_UTILS
	help
	  This option enables generic simple simple sound card support
	  with OF-graph DT bindings.

config SND_AUDIO_GRAPH_SCU_CARD
	tristate "ASoC Audio Graph SCU sound card support"
	depends on OF
	select SND_SIMPLE_CARD_UTILS
	help
	  This option enables generic simple SCU sound card support
	  with OF-graph DT bindings.
	  It supports DPCM of multi CPU single Codec ststem.
```
